    IF :LNOT::DEF:INCLUDED_CYFITTERRV_INC
INCLUDED_CYFITTERRV_INC EQU 1
    GET cydevicerv_trm.inc

; LED_RED
LED_RED__0__DM__MASK EQU 0x1C0000
LED_RED__0__DM__SHIFT EQU 18
LED_RED__0__DR EQU CYREG_PRT1_DR
LED_RED__0__HSIOM EQU CYREG_HSIOM_PORT_SEL1
LED_RED__0__HSIOM_MASK EQU 0x0F000000
LED_RED__0__HSIOM_SHIFT EQU 24
LED_RED__0__INTCFG EQU CYREG_PRT1_INTCFG
LED_RED__0__INTSTAT EQU CYREG_PRT1_INTSTAT
LED_RED__0__MASK EQU 0x40
LED_RED__0__OUT_SEL EQU CYREG_UDB_PA1_CFG10
LED_RED__0__OUT_SEL_SHIFT EQU 12
LED_RED__0__OUT_SEL_VAL EQU 2
LED_RED__0__PA__CFG0 EQU CYREG_UDB_PA1_CFG0
LED_RED__0__PA__CFG1 EQU CYREG_UDB_PA1_CFG1
LED_RED__0__PA__CFG10 EQU CYREG_UDB_PA1_CFG10
LED_RED__0__PA__CFG11 EQU CYREG_UDB_PA1_CFG11
LED_RED__0__PA__CFG12 EQU CYREG_UDB_PA1_CFG12
LED_RED__0__PA__CFG13 EQU CYREG_UDB_PA1_CFG13
LED_RED__0__PA__CFG14 EQU CYREG_UDB_PA1_CFG14
LED_RED__0__PA__CFG2 EQU CYREG_UDB_PA1_CFG2
LED_RED__0__PA__CFG3 EQU CYREG_UDB_PA1_CFG3
LED_RED__0__PA__CFG4 EQU CYREG_UDB_PA1_CFG4
LED_RED__0__PA__CFG5 EQU CYREG_UDB_PA1_CFG5
LED_RED__0__PA__CFG6 EQU CYREG_UDB_PA1_CFG6
LED_RED__0__PA__CFG7 EQU CYREG_UDB_PA1_CFG7
LED_RED__0__PA__CFG8 EQU CYREG_UDB_PA1_CFG8
LED_RED__0__PA__CFG9 EQU CYREG_UDB_PA1_CFG9
LED_RED__0__PC EQU CYREG_PRT1_PC
LED_RED__0__PC2 EQU CYREG_PRT1_PC2
LED_RED__0__PORT EQU 1
LED_RED__0__PS EQU CYREG_PRT1_PS
LED_RED__0__SHIFT EQU 6
LED_RED__DR EQU CYREG_PRT1_DR
LED_RED__INTCFG EQU CYREG_PRT1_INTCFG
LED_RED__INTSTAT EQU CYREG_PRT1_INTSTAT
LED_RED__MASK EQU 0x40
LED_RED__PA__CFG0 EQU CYREG_UDB_PA1_CFG0
LED_RED__PA__CFG1 EQU CYREG_UDB_PA1_CFG1
LED_RED__PA__CFG10 EQU CYREG_UDB_PA1_CFG10
LED_RED__PA__CFG11 EQU CYREG_UDB_PA1_CFG11
LED_RED__PA__CFG12 EQU CYREG_UDB_PA1_CFG12
LED_RED__PA__CFG13 EQU CYREG_UDB_PA1_CFG13
LED_RED__PA__CFG14 EQU CYREG_UDB_PA1_CFG14
LED_RED__PA__CFG2 EQU CYREG_UDB_PA1_CFG2
LED_RED__PA__CFG3 EQU CYREG_UDB_PA1_CFG3
LED_RED__PA__CFG4 EQU CYREG_UDB_PA1_CFG4
LED_RED__PA__CFG5 EQU CYREG_UDB_PA1_CFG5
LED_RED__PA__CFG6 EQU CYREG_UDB_PA1_CFG6
LED_RED__PA__CFG7 EQU CYREG_UDB_PA1_CFG7
LED_RED__PA__CFG8 EQU CYREG_UDB_PA1_CFG8
LED_RED__PA__CFG9 EQU CYREG_UDB_PA1_CFG9
LED_RED__PC EQU CYREG_PRT1_PC
LED_RED__PC2 EQU CYREG_PRT1_PC2
LED_RED__PORT EQU 1
LED_RED__PS EQU CYREG_PRT1_PS
LED_RED__SHIFT EQU 6

; Clock_PWM
Clock_PWM__DIVIDER_MASK EQU 0x0000FFFF
Clock_PWM__ENABLE EQU CYREG_CLK_DIVIDER_C00
Clock_PWM__ENABLE_MASK EQU 0x80000000
Clock_PWM__MASK EQU 0x80000000
Clock_PWM__REGISTER EQU CYREG_CLK_DIVIDER_C00

; LED_GREEN
LED_GREEN__0__DM__MASK EQU 0x1C0
LED_GREEN__0__DM__SHIFT EQU 6
LED_GREEN__0__DR EQU CYREG_PRT0_DR
LED_GREEN__0__HSIOM EQU CYREG_HSIOM_PORT_SEL0
LED_GREEN__0__HSIOM_MASK EQU 0x00000F00
LED_GREEN__0__HSIOM_SHIFT EQU 8
LED_GREEN__0__INTCFG EQU CYREG_PRT0_INTCFG
LED_GREEN__0__INTSTAT EQU CYREG_PRT0_INTSTAT
LED_GREEN__0__MASK EQU 0x04
LED_GREEN__0__OUT_SEL EQU CYREG_UDB_PA0_CFG10
LED_GREEN__0__OUT_SEL_SHIFT EQU 4
LED_GREEN__0__OUT_SEL_VAL EQU 0
LED_GREEN__0__PA__CFG0 EQU CYREG_UDB_PA0_CFG0
LED_GREEN__0__PA__CFG1 EQU CYREG_UDB_PA0_CFG1
LED_GREEN__0__PA__CFG10 EQU CYREG_UDB_PA0_CFG10
LED_GREEN__0__PA__CFG11 EQU CYREG_UDB_PA0_CFG11
LED_GREEN__0__PA__CFG12 EQU CYREG_UDB_PA0_CFG12
LED_GREEN__0__PA__CFG13 EQU CYREG_UDB_PA0_CFG13
LED_GREEN__0__PA__CFG14 EQU CYREG_UDB_PA0_CFG14
LED_GREEN__0__PA__CFG2 EQU CYREG_UDB_PA0_CFG2
LED_GREEN__0__PA__CFG3 EQU CYREG_UDB_PA0_CFG3
LED_GREEN__0__PA__CFG4 EQU CYREG_UDB_PA0_CFG4
LED_GREEN__0__PA__CFG5 EQU CYREG_UDB_PA0_CFG5
LED_GREEN__0__PA__CFG6 EQU CYREG_UDB_PA0_CFG6
LED_GREEN__0__PA__CFG7 EQU CYREG_UDB_PA0_CFG7
LED_GREEN__0__PA__CFG8 EQU CYREG_UDB_PA0_CFG8
LED_GREEN__0__PA__CFG9 EQU CYREG_UDB_PA0_CFG9
LED_GREEN__0__PC EQU CYREG_PRT0_PC
LED_GREEN__0__PC2 EQU CYREG_PRT0_PC2
LED_GREEN__0__PORT EQU 0
LED_GREEN__0__PS EQU CYREG_PRT0_PS
LED_GREEN__0__SHIFT EQU 2
LED_GREEN__DR EQU CYREG_PRT0_DR
LED_GREEN__INTCFG EQU CYREG_PRT0_INTCFG
LED_GREEN__INTSTAT EQU CYREG_PRT0_INTSTAT
LED_GREEN__MASK EQU 0x04
LED_GREEN__PA__CFG0 EQU CYREG_UDB_PA0_CFG0
LED_GREEN__PA__CFG1 EQU CYREG_UDB_PA0_CFG1
LED_GREEN__PA__CFG10 EQU CYREG_UDB_PA0_CFG10
LED_GREEN__PA__CFG11 EQU CYREG_UDB_PA0_CFG11
LED_GREEN__PA__CFG12 EQU CYREG_UDB_PA0_CFG12
LED_GREEN__PA__CFG13 EQU CYREG_UDB_PA0_CFG13
LED_GREEN__PA__CFG14 EQU CYREG_UDB_PA0_CFG14
LED_GREEN__PA__CFG2 EQU CYREG_UDB_PA0_CFG2
LED_GREEN__PA__CFG3 EQU CYREG_UDB_PA0_CFG3
LED_GREEN__PA__CFG4 EQU CYREG_UDB_PA0_CFG4
LED_GREEN__PA__CFG5 EQU CYREG_UDB_PA0_CFG5
LED_GREEN__PA__CFG6 EQU CYREG_UDB_PA0_CFG6
LED_GREEN__PA__CFG7 EQU CYREG_UDB_PA0_CFG7
LED_GREEN__PA__CFG8 EQU CYREG_UDB_PA0_CFG8
LED_GREEN__PA__CFG9 EQU CYREG_UDB_PA0_CFG9
LED_GREEN__PC EQU CYREG_PRT0_PC
LED_GREEN__PC2 EQU CYREG_PRT0_PC2
LED_GREEN__PORT EQU 0
LED_GREEN__PS EQU CYREG_PRT0_PS
LED_GREEN__SHIFT EQU 2

; LED_CONTROL_cy_m0s8_tcpwm_1
LED_CONTROL_cy_m0s8_tcpwm_1__CC EQU CYREG_TCPWM_CNT0_CC
LED_CONTROL_cy_m0s8_tcpwm_1__CC_BUFF EQU CYREG_TCPWM_CNT0_CC_BUFF
LED_CONTROL_cy_m0s8_tcpwm_1__COUNTER EQU CYREG_TCPWM_CNT0_COUNTER
LED_CONTROL_cy_m0s8_tcpwm_1__CTRL EQU CYREG_TCPWM_CNT0_CTRL
LED_CONTROL_cy_m0s8_tcpwm_1__INTR EQU CYREG_TCPWM_CNT0_INTR
LED_CONTROL_cy_m0s8_tcpwm_1__INTR_MASK EQU CYREG_TCPWM_CNT0_INTR_MASK
LED_CONTROL_cy_m0s8_tcpwm_1__INTR_MASKED EQU CYREG_TCPWM_CNT0_INTR_MASKED
LED_CONTROL_cy_m0s8_tcpwm_1__INTR_SET EQU CYREG_TCPWM_CNT0_INTR_SET
LED_CONTROL_cy_m0s8_tcpwm_1__PERIOD EQU CYREG_TCPWM_CNT0_PERIOD
LED_CONTROL_cy_m0s8_tcpwm_1__PERIOD_BUFF EQU CYREG_TCPWM_CNT0_PERIOD_BUFF
LED_CONTROL_cy_m0s8_tcpwm_1__STATUS EQU CYREG_TCPWM_CNT0_STATUS
LED_CONTROL_cy_m0s8_tcpwm_1__TCPWM_CMD EQU CYREG_TCPWM_CMD
LED_CONTROL_cy_m0s8_tcpwm_1__TCPWM_CMDCAPTURE_MASK EQU 0x01
LED_CONTROL_cy_m0s8_tcpwm_1__TCPWM_CMDCAPTURE_SHIFT EQU 0
LED_CONTROL_cy_m0s8_tcpwm_1__TCPWM_CMDRELOAD_MASK EQU 0x100
LED_CONTROL_cy_m0s8_tcpwm_1__TCPWM_CMDRELOAD_SHIFT EQU 8
LED_CONTROL_cy_m0s8_tcpwm_1__TCPWM_CMDSTART_MASK EQU 0x1000000
LED_CONTROL_cy_m0s8_tcpwm_1__TCPWM_CMDSTART_SHIFT EQU 24
LED_CONTROL_cy_m0s8_tcpwm_1__TCPWM_CMDSTOP_MASK EQU 0x10000
LED_CONTROL_cy_m0s8_tcpwm_1__TCPWM_CMDSTOP_SHIFT EQU 16
LED_CONTROL_cy_m0s8_tcpwm_1__TCPWM_CTRL EQU CYREG_TCPWM_CTRL
LED_CONTROL_cy_m0s8_tcpwm_1__TCPWM_CTRL_MASK EQU 0x01
LED_CONTROL_cy_m0s8_tcpwm_1__TCPWM_CTRL_SHIFT EQU 0
LED_CONTROL_cy_m0s8_tcpwm_1__TCPWM_INTR_CAUSE EQU CYREG_TCPWM_INTR_CAUSE
LED_CONTROL_cy_m0s8_tcpwm_1__TCPWM_INTR_CAUSE_MASK EQU 0x01
LED_CONTROL_cy_m0s8_tcpwm_1__TCPWM_INTR_CAUSE_SHIFT EQU 0
LED_CONTROL_cy_m0s8_tcpwm_1__TCPWM_NUMBER EQU 0
LED_CONTROL_cy_m0s8_tcpwm_1__TR_CTRL0 EQU CYREG_TCPWM_CNT0_TR_CTRL0
LED_CONTROL_cy_m0s8_tcpwm_1__TR_CTRL1 EQU CYREG_TCPWM_CNT0_TR_CTRL1
LED_CONTROL_cy_m0s8_tcpwm_1__TR_CTRL2 EQU CYREG_TCPWM_CNT0_TR_CTRL2

; CapSense_CSD_Cmod
CapSense_CSD_Cmod__0__DM__MASK EQU 0x1C0
CapSense_CSD_Cmod__0__DM__SHIFT EQU 6
CapSense_CSD_Cmod__0__DR EQU CYREG_PRT4_DR
CapSense_CSD_Cmod__0__HSIOM EQU CYREG_HSIOM_PORT_SEL4
CapSense_CSD_Cmod__0__HSIOM_MASK EQU 0x00000F00
CapSense_CSD_Cmod__0__HSIOM_SHIFT EQU 8
CapSense_CSD_Cmod__0__INTCFG EQU CYREG_PRT4_INTCFG
CapSense_CSD_Cmod__0__INTSTAT EQU CYREG_PRT4_INTSTAT
CapSense_CSD_Cmod__0__MASK EQU 0x04
CapSense_CSD_Cmod__0__PC EQU CYREG_PRT4_PC
CapSense_CSD_Cmod__0__PC2 EQU CYREG_PRT4_PC2
CapSense_CSD_Cmod__0__PORT EQU 4
CapSense_CSD_Cmod__0__PS EQU CYREG_PRT4_PS
CapSense_CSD_Cmod__0__SHIFT EQU 2
CapSense_CSD_Cmod__Cmod__DM__MASK EQU 0x1C0
CapSense_CSD_Cmod__Cmod__DM__SHIFT EQU 6
CapSense_CSD_Cmod__Cmod__DR EQU CYREG_PRT4_DR
CapSense_CSD_Cmod__Cmod__INTCFG EQU CYREG_PRT4_INTCFG
CapSense_CSD_Cmod__Cmod__INTSTAT EQU CYREG_PRT4_INTSTAT
CapSense_CSD_Cmod__Cmod__MASK EQU 0x04
CapSense_CSD_Cmod__Cmod__PC EQU CYREG_PRT4_PC
CapSense_CSD_Cmod__Cmod__PC2 EQU CYREG_PRT4_PC2
CapSense_CSD_Cmod__Cmod__PORT EQU 4
CapSense_CSD_Cmod__Cmod__PS EQU CYREG_PRT4_PS
CapSense_CSD_Cmod__Cmod__SHIFT EQU 2
CapSense_CSD_Cmod__DR EQU CYREG_PRT4_DR
CapSense_CSD_Cmod__INTCFG EQU CYREG_PRT4_INTCFG
CapSense_CSD_Cmod__INTSTAT EQU CYREG_PRT4_INTSTAT
CapSense_CSD_Cmod__MASK EQU 0x04
CapSense_CSD_Cmod__PC EQU CYREG_PRT4_PC
CapSense_CSD_Cmod__PC2 EQU CYREG_PRT4_PC2
CapSense_CSD_Cmod__PORT EQU 4
CapSense_CSD_Cmod__PS EQU CYREG_PRT4_PS
CapSense_CSD_Cmod__SHIFT EQU 2

; CapSense_CSD_CSD_FFB
CapSense_CSD_CSD_FFB__CSD_CONFIG EQU CYREG_CSD_CONFIG
CapSense_CSD_CSD_FFB__CSD_COUNTER EQU CYREG_CSD_COUNTER
CapSense_CSD_CSD_FFB__CSD_ID EQU CYREG_CSD_ID
CapSense_CSD_CSD_FFB__CSD_INTR EQU CYREG_CSD_INTR
CapSense_CSD_CSD_FFB__CSD_INTR_SET EQU CYREG_CSD_INTR_SET
CapSense_CSD_CSD_FFB__CSD_NUMBER EQU 0
CapSense_CSD_CSD_FFB__CSD_STATUS EQU CYREG_CSD_STATUS

; CapSense_CSD_IDAC1_cy_psoc4_idac
CapSense_CSD_IDAC1_cy_psoc4_idac__CSD_IDAC EQU CYREG_CSD_IDAC
CapSense_CSD_IDAC1_cy_psoc4_idac__CSD_IDAC_SHIFT EQU 0
CapSense_CSD_IDAC1_cy_psoc4_idac__CSD_TRIM1 EQU CYREG_CSD_TRIM1
CapSense_CSD_IDAC1_cy_psoc4_idac__CSD_TRIM1_SHIFT EQU 0
CapSense_CSD_IDAC1_cy_psoc4_idac__CSD_TRIM2 EQU CYREG_CSD_TRIM2
CapSense_CSD_IDAC1_cy_psoc4_idac__CSD_TRIM2_SHIFT EQU 0
CapSense_CSD_IDAC1_cy_psoc4_idac__IDAC_NUMBER EQU 1
CapSense_CSD_IDAC1_cy_psoc4_idac__POLARITY EQU CYREG_CSD_CONFIG
CapSense_CSD_IDAC1_cy_psoc4_idac__POLARITY_SHIFT EQU 16

; CapSense_CSD_IDAC2_cy_psoc4_idac
CapSense_CSD_IDAC2_cy_psoc4_idac__CSD_IDAC EQU CYREG_CSD_IDAC
CapSense_CSD_IDAC2_cy_psoc4_idac__CSD_IDAC_SHIFT EQU 16
CapSense_CSD_IDAC2_cy_psoc4_idac__CSD_TRIM1 EQU CYREG_CSD_TRIM1
CapSense_CSD_IDAC2_cy_psoc4_idac__CSD_TRIM1_SHIFT EQU 4
CapSense_CSD_IDAC2_cy_psoc4_idac__CSD_TRIM2 EQU CYREG_CSD_TRIM2
CapSense_CSD_IDAC2_cy_psoc4_idac__CSD_TRIM2_SHIFT EQU 4
CapSense_CSD_IDAC2_cy_psoc4_idac__IDAC_NUMBER EQU 2
CapSense_CSD_IDAC2_cy_psoc4_idac__POLARITY EQU CYREG_CSD_CONFIG
CapSense_CSD_IDAC2_cy_psoc4_idac__POLARITY_SHIFT EQU 17

; CapSense_CSD_ISR
CapSense_CSD_ISR__INTC_CLR_EN_REG EQU CYREG_CM0_ICER
CapSense_CSD_ISR__INTC_CLR_PD_REG EQU CYREG_CM0_ICPR
CapSense_CSD_ISR__INTC_MASK EQU 0x8000
CapSense_CSD_ISR__INTC_NUMBER EQU 15
CapSense_CSD_ISR__INTC_PRIOR_MASK EQU 0xC0000000
CapSense_CSD_ISR__INTC_PRIOR_NUM EQU 3
CapSense_CSD_ISR__INTC_PRIOR_REG EQU CYREG_CM0_IPR3
CapSense_CSD_ISR__INTC_SET_EN_REG EQU CYREG_CM0_ISER
CapSense_CSD_ISR__INTC_SET_PD_REG EQU CYREG_CM0_ISPR

; CapSense_CSD_SampleClk
CapSense_CSD_SampleClk__DIVIDER_MASK EQU 0x0000FFFF
CapSense_CSD_SampleClk__ENABLE EQU CYREG_CLK_DIVIDER_A00
CapSense_CSD_SampleClk__ENABLE_MASK EQU 0x80000000
CapSense_CSD_SampleClk__MASK EQU 0x80000000
CapSense_CSD_SampleClk__REGISTER EQU CYREG_CLK_DIVIDER_A00

; CapSense_CSD_SenseClk
CapSense_CSD_SenseClk__DIVIDER_MASK EQU 0x0000FFFF
CapSense_CSD_SenseClk__ENABLE EQU CYREG_CLK_DIVIDER_B00
CapSense_CSD_SenseClk__ENABLE_MASK EQU 0x80000000
CapSense_CSD_SenseClk__MASK EQU 0x80000000
CapSense_CSD_SenseClk__REGISTER EQU CYREG_CLK_DIVIDER_B00

; CapSense_CSD_Sns
CapSense_CSD_Sns__0__DM__MASK EQU 0x38
CapSense_CSD_Sns__0__DM__SHIFT EQU 3
CapSense_CSD_Sns__0__DR EQU CYREG_PRT1_DR
CapSense_CSD_Sns__0__HSIOM EQU CYREG_HSIOM_PORT_SEL1
CapSense_CSD_Sns__0__HSIOM_MASK EQU 0x000000F0
CapSense_CSD_Sns__0__HSIOM_SHIFT EQU 4
CapSense_CSD_Sns__0__INTCFG EQU CYREG_PRT1_INTCFG
CapSense_CSD_Sns__0__INTSTAT EQU CYREG_PRT1_INTSTAT
CapSense_CSD_Sns__0__MASK EQU 0x02
CapSense_CSD_Sns__0__PA__CFG0 EQU CYREG_UDB_PA1_CFG0
CapSense_CSD_Sns__0__PA__CFG1 EQU CYREG_UDB_PA1_CFG1
CapSense_CSD_Sns__0__PA__CFG10 EQU CYREG_UDB_PA1_CFG10
CapSense_CSD_Sns__0__PA__CFG11 EQU CYREG_UDB_PA1_CFG11
CapSense_CSD_Sns__0__PA__CFG12 EQU CYREG_UDB_PA1_CFG12
CapSense_CSD_Sns__0__PA__CFG13 EQU CYREG_UDB_PA1_CFG13
CapSense_CSD_Sns__0__PA__CFG14 EQU CYREG_UDB_PA1_CFG14
CapSense_CSD_Sns__0__PA__CFG2 EQU CYREG_UDB_PA1_CFG2
CapSense_CSD_Sns__0__PA__CFG3 EQU CYREG_UDB_PA1_CFG3
CapSense_CSD_Sns__0__PA__CFG4 EQU CYREG_UDB_PA1_CFG4
CapSense_CSD_Sns__0__PA__CFG5 EQU CYREG_UDB_PA1_CFG5
CapSense_CSD_Sns__0__PA__CFG6 EQU CYREG_UDB_PA1_CFG6
CapSense_CSD_Sns__0__PA__CFG7 EQU CYREG_UDB_PA1_CFG7
CapSense_CSD_Sns__0__PA__CFG8 EQU CYREG_UDB_PA1_CFG8
CapSense_CSD_Sns__0__PA__CFG9 EQU CYREG_UDB_PA1_CFG9
CapSense_CSD_Sns__0__PC EQU CYREG_PRT1_PC
CapSense_CSD_Sns__0__PC2 EQU CYREG_PRT1_PC2
CapSense_CSD_Sns__0__PORT EQU 1
CapSense_CSD_Sns__0__PS EQU CYREG_PRT1_PS
CapSense_CSD_Sns__0__SHIFT EQU 1
CapSense_CSD_Sns__1__DM__MASK EQU 0x1C0
CapSense_CSD_Sns__1__DM__SHIFT EQU 6
CapSense_CSD_Sns__1__DR EQU CYREG_PRT1_DR
CapSense_CSD_Sns__1__HSIOM EQU CYREG_HSIOM_PORT_SEL1
CapSense_CSD_Sns__1__HSIOM_MASK EQU 0x00000F00
CapSense_CSD_Sns__1__HSIOM_SHIFT EQU 8
CapSense_CSD_Sns__1__INTCFG EQU CYREG_PRT1_INTCFG
CapSense_CSD_Sns__1__INTSTAT EQU CYREG_PRT1_INTSTAT
CapSense_CSD_Sns__1__MASK EQU 0x04
CapSense_CSD_Sns__1__PA__CFG0 EQU CYREG_UDB_PA1_CFG0
CapSense_CSD_Sns__1__PA__CFG1 EQU CYREG_UDB_PA1_CFG1
CapSense_CSD_Sns__1__PA__CFG10 EQU CYREG_UDB_PA1_CFG10
CapSense_CSD_Sns__1__PA__CFG11 EQU CYREG_UDB_PA1_CFG11
CapSense_CSD_Sns__1__PA__CFG12 EQU CYREG_UDB_PA1_CFG12
CapSense_CSD_Sns__1__PA__CFG13 EQU CYREG_UDB_PA1_CFG13
CapSense_CSD_Sns__1__PA__CFG14 EQU CYREG_UDB_PA1_CFG14
CapSense_CSD_Sns__1__PA__CFG2 EQU CYREG_UDB_PA1_CFG2
CapSense_CSD_Sns__1__PA__CFG3 EQU CYREG_UDB_PA1_CFG3
CapSense_CSD_Sns__1__PA__CFG4 EQU CYREG_UDB_PA1_CFG4
CapSense_CSD_Sns__1__PA__CFG5 EQU CYREG_UDB_PA1_CFG5
CapSense_CSD_Sns__1__PA__CFG6 EQU CYREG_UDB_PA1_CFG6
CapSense_CSD_Sns__1__PA__CFG7 EQU CYREG_UDB_PA1_CFG7
CapSense_CSD_Sns__1__PA__CFG8 EQU CYREG_UDB_PA1_CFG8
CapSense_CSD_Sns__1__PA__CFG9 EQU CYREG_UDB_PA1_CFG9
CapSense_CSD_Sns__1__PC EQU CYREG_PRT1_PC
CapSense_CSD_Sns__1__PC2 EQU CYREG_PRT1_PC2
CapSense_CSD_Sns__1__PORT EQU 1
CapSense_CSD_Sns__1__PS EQU CYREG_PRT1_PS
CapSense_CSD_Sns__1__SHIFT EQU 2
CapSense_CSD_Sns__2__DM__MASK EQU 0xE00
CapSense_CSD_Sns__2__DM__SHIFT EQU 9
CapSense_CSD_Sns__2__DR EQU CYREG_PRT1_DR
CapSense_CSD_Sns__2__HSIOM EQU CYREG_HSIOM_PORT_SEL1
CapSense_CSD_Sns__2__HSIOM_MASK EQU 0x0000F000
CapSense_CSD_Sns__2__HSIOM_SHIFT EQU 12
CapSense_CSD_Sns__2__INTCFG EQU CYREG_PRT1_INTCFG
CapSense_CSD_Sns__2__INTSTAT EQU CYREG_PRT1_INTSTAT
CapSense_CSD_Sns__2__MASK EQU 0x08
CapSense_CSD_Sns__2__PA__CFG0 EQU CYREG_UDB_PA1_CFG0
CapSense_CSD_Sns__2__PA__CFG1 EQU CYREG_UDB_PA1_CFG1
CapSense_CSD_Sns__2__PA__CFG10 EQU CYREG_UDB_PA1_CFG10
CapSense_CSD_Sns__2__PA__CFG11 EQU CYREG_UDB_PA1_CFG11
CapSense_CSD_Sns__2__PA__CFG12 EQU CYREG_UDB_PA1_CFG12
CapSense_CSD_Sns__2__PA__CFG13 EQU CYREG_UDB_PA1_CFG13
CapSense_CSD_Sns__2__PA__CFG14 EQU CYREG_UDB_PA1_CFG14
CapSense_CSD_Sns__2__PA__CFG2 EQU CYREG_UDB_PA1_CFG2
CapSense_CSD_Sns__2__PA__CFG3 EQU CYREG_UDB_PA1_CFG3
CapSense_CSD_Sns__2__PA__CFG4 EQU CYREG_UDB_PA1_CFG4
CapSense_CSD_Sns__2__PA__CFG5 EQU CYREG_UDB_PA1_CFG5
CapSense_CSD_Sns__2__PA__CFG6 EQU CYREG_UDB_PA1_CFG6
CapSense_CSD_Sns__2__PA__CFG7 EQU CYREG_UDB_PA1_CFG7
CapSense_CSD_Sns__2__PA__CFG8 EQU CYREG_UDB_PA1_CFG8
CapSense_CSD_Sns__2__PA__CFG9 EQU CYREG_UDB_PA1_CFG9
CapSense_CSD_Sns__2__PC EQU CYREG_PRT1_PC
CapSense_CSD_Sns__2__PC2 EQU CYREG_PRT1_PC2
CapSense_CSD_Sns__2__PORT EQU 1
CapSense_CSD_Sns__2__PS EQU CYREG_PRT1_PS
CapSense_CSD_Sns__2__SHIFT EQU 3
CapSense_CSD_Sns__3__DM__MASK EQU 0x7000
CapSense_CSD_Sns__3__DM__SHIFT EQU 12
CapSense_CSD_Sns__3__DR EQU CYREG_PRT1_DR
CapSense_CSD_Sns__3__HSIOM EQU CYREG_HSIOM_PORT_SEL1
CapSense_CSD_Sns__3__HSIOM_MASK EQU 0x000F0000
CapSense_CSD_Sns__3__HSIOM_SHIFT EQU 16
CapSense_CSD_Sns__3__INTCFG EQU CYREG_PRT1_INTCFG
CapSense_CSD_Sns__3__INTSTAT EQU CYREG_PRT1_INTSTAT
CapSense_CSD_Sns__3__MASK EQU 0x10
CapSense_CSD_Sns__3__PA__CFG0 EQU CYREG_UDB_PA1_CFG0
CapSense_CSD_Sns__3__PA__CFG1 EQU CYREG_UDB_PA1_CFG1
CapSense_CSD_Sns__3__PA__CFG10 EQU CYREG_UDB_PA1_CFG10
CapSense_CSD_Sns__3__PA__CFG11 EQU CYREG_UDB_PA1_CFG11
CapSense_CSD_Sns__3__PA__CFG12 EQU CYREG_UDB_PA1_CFG12
CapSense_CSD_Sns__3__PA__CFG13 EQU CYREG_UDB_PA1_CFG13
CapSense_CSD_Sns__3__PA__CFG14 EQU CYREG_UDB_PA1_CFG14
CapSense_CSD_Sns__3__PA__CFG2 EQU CYREG_UDB_PA1_CFG2
CapSense_CSD_Sns__3__PA__CFG3 EQU CYREG_UDB_PA1_CFG3
CapSense_CSD_Sns__3__PA__CFG4 EQU CYREG_UDB_PA1_CFG4
CapSense_CSD_Sns__3__PA__CFG5 EQU CYREG_UDB_PA1_CFG5
CapSense_CSD_Sns__3__PA__CFG6 EQU CYREG_UDB_PA1_CFG6
CapSense_CSD_Sns__3__PA__CFG7 EQU CYREG_UDB_PA1_CFG7
CapSense_CSD_Sns__3__PA__CFG8 EQU CYREG_UDB_PA1_CFG8
CapSense_CSD_Sns__3__PA__CFG9 EQU CYREG_UDB_PA1_CFG9
CapSense_CSD_Sns__3__PC EQU CYREG_PRT1_PC
CapSense_CSD_Sns__3__PC2 EQU CYREG_PRT1_PC2
CapSense_CSD_Sns__3__PORT EQU 1
CapSense_CSD_Sns__3__PS EQU CYREG_PRT1_PS
CapSense_CSD_Sns__3__SHIFT EQU 4
CapSense_CSD_Sns__4__DM__MASK EQU 0x38000
CapSense_CSD_Sns__4__DM__SHIFT EQU 15
CapSense_CSD_Sns__4__DR EQU CYREG_PRT1_DR
CapSense_CSD_Sns__4__HSIOM EQU CYREG_HSIOM_PORT_SEL1
CapSense_CSD_Sns__4__HSIOM_MASK EQU 0x00F00000
CapSense_CSD_Sns__4__HSIOM_SHIFT EQU 20
CapSense_CSD_Sns__4__INTCFG EQU CYREG_PRT1_INTCFG
CapSense_CSD_Sns__4__INTSTAT EQU CYREG_PRT1_INTSTAT
CapSense_CSD_Sns__4__MASK EQU 0x20
CapSense_CSD_Sns__4__PA__CFG0 EQU CYREG_UDB_PA1_CFG0
CapSense_CSD_Sns__4__PA__CFG1 EQU CYREG_UDB_PA1_CFG1
CapSense_CSD_Sns__4__PA__CFG10 EQU CYREG_UDB_PA1_CFG10
CapSense_CSD_Sns__4__PA__CFG11 EQU CYREG_UDB_PA1_CFG11
CapSense_CSD_Sns__4__PA__CFG12 EQU CYREG_UDB_PA1_CFG12
CapSense_CSD_Sns__4__PA__CFG13 EQU CYREG_UDB_PA1_CFG13
CapSense_CSD_Sns__4__PA__CFG14 EQU CYREG_UDB_PA1_CFG14
CapSense_CSD_Sns__4__PA__CFG2 EQU CYREG_UDB_PA1_CFG2
CapSense_CSD_Sns__4__PA__CFG3 EQU CYREG_UDB_PA1_CFG3
CapSense_CSD_Sns__4__PA__CFG4 EQU CYREG_UDB_PA1_CFG4
CapSense_CSD_Sns__4__PA__CFG5 EQU CYREG_UDB_PA1_CFG5
CapSense_CSD_Sns__4__PA__CFG6 EQU CYREG_UDB_PA1_CFG6
CapSense_CSD_Sns__4__PA__CFG7 EQU CYREG_UDB_PA1_CFG7
CapSense_CSD_Sns__4__PA__CFG8 EQU CYREG_UDB_PA1_CFG8
CapSense_CSD_Sns__4__PA__CFG9 EQU CYREG_UDB_PA1_CFG9
CapSense_CSD_Sns__4__PC EQU CYREG_PRT1_PC
CapSense_CSD_Sns__4__PC2 EQU CYREG_PRT1_PC2
CapSense_CSD_Sns__4__PORT EQU 1
CapSense_CSD_Sns__4__PS EQU CYREG_PRT1_PS
CapSense_CSD_Sns__4__SHIFT EQU 5
CapSense_CSD_Sns__DR EQU CYREG_PRT1_DR
CapSense_CSD_Sns__INTCFG EQU CYREG_PRT1_INTCFG
CapSense_CSD_Sns__INTSTAT EQU CYREG_PRT1_INTSTAT
CapSense_CSD_Sns__LinearSlider0_e0__LS__DM__MASK EQU 0x38
CapSense_CSD_Sns__LinearSlider0_e0__LS__DM__SHIFT EQU 3
CapSense_CSD_Sns__LinearSlider0_e0__LS__DR EQU CYREG_PRT1_DR
CapSense_CSD_Sns__LinearSlider0_e0__LS__INTCFG EQU CYREG_PRT1_INTCFG
CapSense_CSD_Sns__LinearSlider0_e0__LS__INTSTAT EQU CYREG_PRT1_INTSTAT
CapSense_CSD_Sns__LinearSlider0_e0__LS__MASK EQU 0x02
CapSense_CSD_Sns__LinearSlider0_e0__LS__PA__CFG0 EQU CYREG_UDB_PA1_CFG0
CapSense_CSD_Sns__LinearSlider0_e0__LS__PA__CFG1 EQU CYREG_UDB_PA1_CFG1
CapSense_CSD_Sns__LinearSlider0_e0__LS__PA__CFG10 EQU CYREG_UDB_PA1_CFG10
CapSense_CSD_Sns__LinearSlider0_e0__LS__PA__CFG11 EQU CYREG_UDB_PA1_CFG11
CapSense_CSD_Sns__LinearSlider0_e0__LS__PA__CFG12 EQU CYREG_UDB_PA1_CFG12
CapSense_CSD_Sns__LinearSlider0_e0__LS__PA__CFG13 EQU CYREG_UDB_PA1_CFG13
CapSense_CSD_Sns__LinearSlider0_e0__LS__PA__CFG14 EQU CYREG_UDB_PA1_CFG14
CapSense_CSD_Sns__LinearSlider0_e0__LS__PA__CFG2 EQU CYREG_UDB_PA1_CFG2
CapSense_CSD_Sns__LinearSlider0_e0__LS__PA__CFG3 EQU CYREG_UDB_PA1_CFG3
CapSense_CSD_Sns__LinearSlider0_e0__LS__PA__CFG4 EQU CYREG_UDB_PA1_CFG4
CapSense_CSD_Sns__LinearSlider0_e0__LS__PA__CFG5 EQU CYREG_UDB_PA1_CFG5
CapSense_CSD_Sns__LinearSlider0_e0__LS__PA__CFG6 EQU CYREG_UDB_PA1_CFG6
CapSense_CSD_Sns__LinearSlider0_e0__LS__PA__CFG7 EQU CYREG_UDB_PA1_CFG7
CapSense_CSD_Sns__LinearSlider0_e0__LS__PA__CFG8 EQU CYREG_UDB_PA1_CFG8
CapSense_CSD_Sns__LinearSlider0_e0__LS__PA__CFG9 EQU CYREG_UDB_PA1_CFG9
CapSense_CSD_Sns__LinearSlider0_e0__LS__PC EQU CYREG_PRT1_PC
CapSense_CSD_Sns__LinearSlider0_e0__LS__PC2 EQU CYREG_PRT1_PC2
CapSense_CSD_Sns__LinearSlider0_e0__LS__PORT EQU 1
CapSense_CSD_Sns__LinearSlider0_e0__LS__PS EQU CYREG_PRT1_PS
CapSense_CSD_Sns__LinearSlider0_e0__LS__SHIFT EQU 1
CapSense_CSD_Sns__LinearSlider0_e1__LS__DM__MASK EQU 0x1C0
CapSense_CSD_Sns__LinearSlider0_e1__LS__DM__SHIFT EQU 6
CapSense_CSD_Sns__LinearSlider0_e1__LS__DR EQU CYREG_PRT1_DR
CapSense_CSD_Sns__LinearSlider0_e1__LS__INTCFG EQU CYREG_PRT1_INTCFG
CapSense_CSD_Sns__LinearSlider0_e1__LS__INTSTAT EQU CYREG_PRT1_INTSTAT
CapSense_CSD_Sns__LinearSlider0_e1__LS__MASK EQU 0x04
CapSense_CSD_Sns__LinearSlider0_e1__LS__PA__CFG0 EQU CYREG_UDB_PA1_CFG0
CapSense_CSD_Sns__LinearSlider0_e1__LS__PA__CFG1 EQU CYREG_UDB_PA1_CFG1
CapSense_CSD_Sns__LinearSlider0_e1__LS__PA__CFG10 EQU CYREG_UDB_PA1_CFG10
CapSense_CSD_Sns__LinearSlider0_e1__LS__PA__CFG11 EQU CYREG_UDB_PA1_CFG11
CapSense_CSD_Sns__LinearSlider0_e1__LS__PA__CFG12 EQU CYREG_UDB_PA1_CFG12
CapSense_CSD_Sns__LinearSlider0_e1__LS__PA__CFG13 EQU CYREG_UDB_PA1_CFG13
CapSense_CSD_Sns__LinearSlider0_e1__LS__PA__CFG14 EQU CYREG_UDB_PA1_CFG14
CapSense_CSD_Sns__LinearSlider0_e1__LS__PA__CFG2 EQU CYREG_UDB_PA1_CFG2
CapSense_CSD_Sns__LinearSlider0_e1__LS__PA__CFG3 EQU CYREG_UDB_PA1_CFG3
CapSense_CSD_Sns__LinearSlider0_e1__LS__PA__CFG4 EQU CYREG_UDB_PA1_CFG4
CapSense_CSD_Sns__LinearSlider0_e1__LS__PA__CFG5 EQU CYREG_UDB_PA1_CFG5
CapSense_CSD_Sns__LinearSlider0_e1__LS__PA__CFG6 EQU CYREG_UDB_PA1_CFG6
CapSense_CSD_Sns__LinearSlider0_e1__LS__PA__CFG7 EQU CYREG_UDB_PA1_CFG7
CapSense_CSD_Sns__LinearSlider0_e1__LS__PA__CFG8 EQU CYREG_UDB_PA1_CFG8
CapSense_CSD_Sns__LinearSlider0_e1__LS__PA__CFG9 EQU CYREG_UDB_PA1_CFG9
CapSense_CSD_Sns__LinearSlider0_e1__LS__PC EQU CYREG_PRT1_PC
CapSense_CSD_Sns__LinearSlider0_e1__LS__PC2 EQU CYREG_PRT1_PC2
CapSense_CSD_Sns__LinearSlider0_e1__LS__PORT EQU 1
CapSense_CSD_Sns__LinearSlider0_e1__LS__PS EQU CYREG_PRT1_PS
CapSense_CSD_Sns__LinearSlider0_e1__LS__SHIFT EQU 2
CapSense_CSD_Sns__LinearSlider0_e2__LS__DM__MASK EQU 0xE00
CapSense_CSD_Sns__LinearSlider0_e2__LS__DM__SHIFT EQU 9
CapSense_CSD_Sns__LinearSlider0_e2__LS__DR EQU CYREG_PRT1_DR
CapSense_CSD_Sns__LinearSlider0_e2__LS__INTCFG EQU CYREG_PRT1_INTCFG
CapSense_CSD_Sns__LinearSlider0_e2__LS__INTSTAT EQU CYREG_PRT1_INTSTAT
CapSense_CSD_Sns__LinearSlider0_e2__LS__MASK EQU 0x08
CapSense_CSD_Sns__LinearSlider0_e2__LS__PA__CFG0 EQU CYREG_UDB_PA1_CFG0
CapSense_CSD_Sns__LinearSlider0_e2__LS__PA__CFG1 EQU CYREG_UDB_PA1_CFG1
CapSense_CSD_Sns__LinearSlider0_e2__LS__PA__CFG10 EQU CYREG_UDB_PA1_CFG10
CapSense_CSD_Sns__LinearSlider0_e2__LS__PA__CFG11 EQU CYREG_UDB_PA1_CFG11
CapSense_CSD_Sns__LinearSlider0_e2__LS__PA__CFG12 EQU CYREG_UDB_PA1_CFG12
CapSense_CSD_Sns__LinearSlider0_e2__LS__PA__CFG13 EQU CYREG_UDB_PA1_CFG13
CapSense_CSD_Sns__LinearSlider0_e2__LS__PA__CFG14 EQU CYREG_UDB_PA1_CFG14
CapSense_CSD_Sns__LinearSlider0_e2__LS__PA__CFG2 EQU CYREG_UDB_PA1_CFG2
CapSense_CSD_Sns__LinearSlider0_e2__LS__PA__CFG3 EQU CYREG_UDB_PA1_CFG3
CapSense_CSD_Sns__LinearSlider0_e2__LS__PA__CFG4 EQU CYREG_UDB_PA1_CFG4
CapSense_CSD_Sns__LinearSlider0_e2__LS__PA__CFG5 EQU CYREG_UDB_PA1_CFG5
CapSense_CSD_Sns__LinearSlider0_e2__LS__PA__CFG6 EQU CYREG_UDB_PA1_CFG6
CapSense_CSD_Sns__LinearSlider0_e2__LS__PA__CFG7 EQU CYREG_UDB_PA1_CFG7
CapSense_CSD_Sns__LinearSlider0_e2__LS__PA__CFG8 EQU CYREG_UDB_PA1_CFG8
CapSense_CSD_Sns__LinearSlider0_e2__LS__PA__CFG9 EQU CYREG_UDB_PA1_CFG9
CapSense_CSD_Sns__LinearSlider0_e2__LS__PC EQU CYREG_PRT1_PC
CapSense_CSD_Sns__LinearSlider0_e2__LS__PC2 EQU CYREG_PRT1_PC2
CapSense_CSD_Sns__LinearSlider0_e2__LS__PORT EQU 1
CapSense_CSD_Sns__LinearSlider0_e2__LS__PS EQU CYREG_PRT1_PS
CapSense_CSD_Sns__LinearSlider0_e2__LS__SHIFT EQU 3
CapSense_CSD_Sns__LinearSlider0_e3__LS__DM__MASK EQU 0x7000
CapSense_CSD_Sns__LinearSlider0_e3__LS__DM__SHIFT EQU 12
CapSense_CSD_Sns__LinearSlider0_e3__LS__DR EQU CYREG_PRT1_DR
CapSense_CSD_Sns__LinearSlider0_e3__LS__INTCFG EQU CYREG_PRT1_INTCFG
CapSense_CSD_Sns__LinearSlider0_e3__LS__INTSTAT EQU CYREG_PRT1_INTSTAT
CapSense_CSD_Sns__LinearSlider0_e3__LS__MASK EQU 0x10
CapSense_CSD_Sns__LinearSlider0_e3__LS__PA__CFG0 EQU CYREG_UDB_PA1_CFG0
CapSense_CSD_Sns__LinearSlider0_e3__LS__PA__CFG1 EQU CYREG_UDB_PA1_CFG1
CapSense_CSD_Sns__LinearSlider0_e3__LS__PA__CFG10 EQU CYREG_UDB_PA1_CFG10
CapSense_CSD_Sns__LinearSlider0_e3__LS__PA__CFG11 EQU CYREG_UDB_PA1_CFG11
CapSense_CSD_Sns__LinearSlider0_e3__LS__PA__CFG12 EQU CYREG_UDB_PA1_CFG12
CapSense_CSD_Sns__LinearSlider0_e3__LS__PA__CFG13 EQU CYREG_UDB_PA1_CFG13
CapSense_CSD_Sns__LinearSlider0_e3__LS__PA__CFG14 EQU CYREG_UDB_PA1_CFG14
CapSense_CSD_Sns__LinearSlider0_e3__LS__PA__CFG2 EQU CYREG_UDB_PA1_CFG2
CapSense_CSD_Sns__LinearSlider0_e3__LS__PA__CFG3 EQU CYREG_UDB_PA1_CFG3
CapSense_CSD_Sns__LinearSlider0_e3__LS__PA__CFG4 EQU CYREG_UDB_PA1_CFG4
CapSense_CSD_Sns__LinearSlider0_e3__LS__PA__CFG5 EQU CYREG_UDB_PA1_CFG5
CapSense_CSD_Sns__LinearSlider0_e3__LS__PA__CFG6 EQU CYREG_UDB_PA1_CFG6
CapSense_CSD_Sns__LinearSlider0_e3__LS__PA__CFG7 EQU CYREG_UDB_PA1_CFG7
CapSense_CSD_Sns__LinearSlider0_e3__LS__PA__CFG8 EQU CYREG_UDB_PA1_CFG8
CapSense_CSD_Sns__LinearSlider0_e3__LS__PA__CFG9 EQU CYREG_UDB_PA1_CFG9
CapSense_CSD_Sns__LinearSlider0_e3__LS__PC EQU CYREG_PRT1_PC
CapSense_CSD_Sns__LinearSlider0_e3__LS__PC2 EQU CYREG_PRT1_PC2
CapSense_CSD_Sns__LinearSlider0_e3__LS__PORT EQU 1
CapSense_CSD_Sns__LinearSlider0_e3__LS__PS EQU CYREG_PRT1_PS
CapSense_CSD_Sns__LinearSlider0_e3__LS__SHIFT EQU 4
CapSense_CSD_Sns__LinearSlider0_e4__LS__DM__MASK EQU 0x38000
CapSense_CSD_Sns__LinearSlider0_e4__LS__DM__SHIFT EQU 15
CapSense_CSD_Sns__LinearSlider0_e4__LS__DR EQU CYREG_PRT1_DR
CapSense_CSD_Sns__LinearSlider0_e4__LS__INTCFG EQU CYREG_PRT1_INTCFG
CapSense_CSD_Sns__LinearSlider0_e4__LS__INTSTAT EQU CYREG_PRT1_INTSTAT
CapSense_CSD_Sns__LinearSlider0_e4__LS__MASK EQU 0x20
CapSense_CSD_Sns__LinearSlider0_e4__LS__PA__CFG0 EQU CYREG_UDB_PA1_CFG0
CapSense_CSD_Sns__LinearSlider0_e4__LS__PA__CFG1 EQU CYREG_UDB_PA1_CFG1
CapSense_CSD_Sns__LinearSlider0_e4__LS__PA__CFG10 EQU CYREG_UDB_PA1_CFG10
CapSense_CSD_Sns__LinearSlider0_e4__LS__PA__CFG11 EQU CYREG_UDB_PA1_CFG11
CapSense_CSD_Sns__LinearSlider0_e4__LS__PA__CFG12 EQU CYREG_UDB_PA1_CFG12
CapSense_CSD_Sns__LinearSlider0_e4__LS__PA__CFG13 EQU CYREG_UDB_PA1_CFG13
CapSense_CSD_Sns__LinearSlider0_e4__LS__PA__CFG14 EQU CYREG_UDB_PA1_CFG14
CapSense_CSD_Sns__LinearSlider0_e4__LS__PA__CFG2 EQU CYREG_UDB_PA1_CFG2
CapSense_CSD_Sns__LinearSlider0_e4__LS__PA__CFG3 EQU CYREG_UDB_PA1_CFG3
CapSense_CSD_Sns__LinearSlider0_e4__LS__PA__CFG4 EQU CYREG_UDB_PA1_CFG4
CapSense_CSD_Sns__LinearSlider0_e4__LS__PA__CFG5 EQU CYREG_UDB_PA1_CFG5
CapSense_CSD_Sns__LinearSlider0_e4__LS__PA__CFG6 EQU CYREG_UDB_PA1_CFG6
CapSense_CSD_Sns__LinearSlider0_e4__LS__PA__CFG7 EQU CYREG_UDB_PA1_CFG7
CapSense_CSD_Sns__LinearSlider0_e4__LS__PA__CFG8 EQU CYREG_UDB_PA1_CFG8
CapSense_CSD_Sns__LinearSlider0_e4__LS__PA__CFG9 EQU CYREG_UDB_PA1_CFG9
CapSense_CSD_Sns__LinearSlider0_e4__LS__PC EQU CYREG_PRT1_PC
CapSense_CSD_Sns__LinearSlider0_e4__LS__PC2 EQU CYREG_PRT1_PC2
CapSense_CSD_Sns__LinearSlider0_e4__LS__PORT EQU 1
CapSense_CSD_Sns__LinearSlider0_e4__LS__PS EQU CYREG_PRT1_PS
CapSense_CSD_Sns__LinearSlider0_e4__LS__SHIFT EQU 5
CapSense_CSD_Sns__PA__CFG0 EQU CYREG_UDB_PA1_CFG0
CapSense_CSD_Sns__PA__CFG1 EQU CYREG_UDB_PA1_CFG1
CapSense_CSD_Sns__PA__CFG10 EQU CYREG_UDB_PA1_CFG10
CapSense_CSD_Sns__PA__CFG11 EQU CYREG_UDB_PA1_CFG11
CapSense_CSD_Sns__PA__CFG12 EQU CYREG_UDB_PA1_CFG12
CapSense_CSD_Sns__PA__CFG13 EQU CYREG_UDB_PA1_CFG13
CapSense_CSD_Sns__PA__CFG14 EQU CYREG_UDB_PA1_CFG14
CapSense_CSD_Sns__PA__CFG2 EQU CYREG_UDB_PA1_CFG2
CapSense_CSD_Sns__PA__CFG3 EQU CYREG_UDB_PA1_CFG3
CapSense_CSD_Sns__PA__CFG4 EQU CYREG_UDB_PA1_CFG4
CapSense_CSD_Sns__PA__CFG5 EQU CYREG_UDB_PA1_CFG5
CapSense_CSD_Sns__PA__CFG6 EQU CYREG_UDB_PA1_CFG6
CapSense_CSD_Sns__PA__CFG7 EQU CYREG_UDB_PA1_CFG7
CapSense_CSD_Sns__PA__CFG8 EQU CYREG_UDB_PA1_CFG8
CapSense_CSD_Sns__PA__CFG9 EQU CYREG_UDB_PA1_CFG9
CapSense_CSD_Sns__PC EQU CYREG_PRT1_PC
CapSense_CSD_Sns__PC2 EQU CYREG_PRT1_PC2
CapSense_CSD_Sns__PORT EQU 1
CapSense_CSD_Sns__PS EQU CYREG_PRT1_PS

; Miscellaneous
CYDEV_BCLK__HFCLK__HZ EQU 24000000
CYDEV_BCLK__HFCLK__KHZ EQU 24000
CYDEV_BCLK__HFCLK__MHZ EQU 24
CYDEV_BCLK__SYSCLK__HZ EQU 24000000
CYDEV_BCLK__SYSCLK__KHZ EQU 24000
CYDEV_BCLK__SYSCLK__MHZ EQU 24
CYDEV_CHIP_DIE_LEOPARD EQU 1
CYDEV_CHIP_DIE_PANTHER EQU 4
CYDEV_CHIP_DIE_PSOC4A EQU 2
CYDEV_CHIP_DIE_PSOC5LP EQU 5
CYDEV_CHIP_DIE_UNKNOWN EQU 0
CYDEV_CHIP_FAMILY_PSOC3 EQU 1
CYDEV_CHIP_FAMILY_PSOC4 EQU 2
CYDEV_CHIP_FAMILY_PSOC5 EQU 3
CYDEV_CHIP_FAMILY_UNKNOWN EQU 0
CYDEV_CHIP_FAMILY_USED EQU CYDEV_CHIP_FAMILY_PSOC4
CYDEV_CHIP_JTAG_ID EQU 0x04C81193
CYDEV_CHIP_MEMBER_3A EQU 1
CYDEV_CHIP_MEMBER_4A EQU 2
CYDEV_CHIP_MEMBER_4D EQU 3
CYDEV_CHIP_MEMBER_5A EQU 4
CYDEV_CHIP_MEMBER_5B EQU 5
CYDEV_CHIP_MEMBER_UNKNOWN EQU 0
CYDEV_CHIP_MEMBER_USED EQU CYDEV_CHIP_MEMBER_4A
CYDEV_CHIP_DIE_EXPECT EQU CYDEV_CHIP_MEMBER_USED
CYDEV_CHIP_DIE_ACTUAL EQU CYDEV_CHIP_DIE_EXPECT
CYDEV_CHIP_REV_LEOPARD_ES1 EQU 0
CYDEV_CHIP_REV_LEOPARD_ES2 EQU 1
CYDEV_CHIP_REV_LEOPARD_ES3 EQU 3
CYDEV_CHIP_REV_LEOPARD_PRODUCTION EQU 3
CYDEV_CHIP_REV_PANTHER_ES0 EQU 0
CYDEV_CHIP_REV_PANTHER_ES1 EQU 1
CYDEV_CHIP_REV_PANTHER_PRODUCTION EQU 1
CYDEV_CHIP_REV_PSOC4A_ES0 EQU 17
CYDEV_CHIP_REV_PSOC4A_PRODUCTION EQU 17
CYDEV_CHIP_REV_PSOC5LP_ES0 EQU 0
CYDEV_CHIP_REV_PSOC5LP_PRODUCTION EQU 0
CYDEV_CHIP_REVISION_3A_ES1 EQU 0
CYDEV_CHIP_REVISION_3A_ES2 EQU 1
CYDEV_CHIP_REVISION_3A_ES3 EQU 3
CYDEV_CHIP_REVISION_3A_PRODUCTION EQU 3
CYDEV_CHIP_REVISION_4A_ES0 EQU 17
CYDEV_CHIP_REVISION_4A_PRODUCTION EQU 17
CYDEV_CHIP_REVISION_4D_ES0 EQU 0
CYDEV_CHIP_REVISION_4D_PRODUCTION EQU 0
CYDEV_CHIP_REVISION_5A_ES0 EQU 0
CYDEV_CHIP_REVISION_5A_ES1 EQU 1
CYDEV_CHIP_REVISION_5A_PRODUCTION EQU 1
CYDEV_CHIP_REVISION_5B_ES0 EQU 0
CYDEV_CHIP_REVISION_5B_PRODUCTION EQU 0
CYDEV_CHIP_REVISION_USED EQU CYDEV_CHIP_REVISION_4A_PRODUCTION
CYDEV_CHIP_REV_EXPECT EQU CYDEV_CHIP_REVISION_USED
CYDEV_CONFIG_READ_ACCELERATOR EQU 1
CYDEV_CONFIG_UNUSED_IO_AllowButWarn EQU 0
CYDEV_CONFIG_UNUSED_IO EQU CYDEV_CONFIG_UNUSED_IO_AllowButWarn
CYDEV_CONFIG_UNUSED_IO_AllowWithInfo EQU 1
CYDEV_CONFIG_UNUSED_IO_Disallowed EQU 2
CYDEV_CONFIGURATION_COMPRESSED EQU 1
CYDEV_CONFIGURATION_MODE_COMPRESSED EQU 0
CYDEV_CONFIGURATION_MODE EQU CYDEV_CONFIGURATION_MODE_COMPRESSED
CYDEV_CONFIGURATION_MODE_DMA EQU 2
CYDEV_CONFIGURATION_MODE_UNCOMPRESSED EQU 1
CYDEV_DEBUG_PROTECT_KILL EQU 4
CYDEV_DEBUG_PROTECT_OPEN EQU 1
CYDEV_DEBUG_PROTECT EQU CYDEV_DEBUG_PROTECT_OPEN
CYDEV_DEBUG_PROTECT_PROTECTED EQU 2
CYDEV_DEBUGGING_DPS_Disable EQU 3
CYDEV_DEBUGGING_DPS_SWD EQU 2
CYDEV_DEBUGGING_DPS EQU CYDEV_DEBUGGING_DPS_SWD
CYDEV_DEBUGGING_ENABLE EQU 1
CYDEV_HEAP_SIZE EQU 0x0100
CYDEV_PROJ_TYPE EQU 0
CYDEV_PROJ_TYPE_BOOTLOADER EQU 1
CYDEV_PROJ_TYPE_LOADABLE EQU 2
CYDEV_PROJ_TYPE_MULTIAPPBOOTLOADER EQU 3
CYDEV_PROJ_TYPE_STANDARD EQU 0
CYDEV_STACK_SIZE EQU 0x0400
CYDEV_USE_BUNDLED_CMSIS EQU 1
CYDEV_VARIABLE_VDDA EQU 1
CYDEV_VDDA_MV EQU 3300
CYDEV_VDDD_MV EQU 3300
CYIPBLOCK_M0S8_CTBM_VERSION EQU 0
CYIPBLOCK_m0s8cpuss_VERSION EQU 0
CYIPBLOCK_m0s8csd_VERSION EQU 0
CYIPBLOCK_m0s8gpio2_VERSION EQU 0
CYIPBLOCK_m0s8hsiom4a_VERSION EQU 0
CYIPBLOCK_m0s8lcd_VERSION EQU 0
CYIPBLOCK_m0s8lpcomp_VERSION EQU 0
CYIPBLOCK_m0s8pclk_VERSION EQU 0
CYIPBLOCK_m0s8sar_VERSION EQU 0
CYIPBLOCK_m0s8scb_VERSION EQU 0
CYIPBLOCK_m0s8srssv2_VERSION EQU 1
CYIPBLOCK_m0s8tcpwm_VERSION EQU 0
CYIPBLOCK_m0s8udbif_VERSION EQU 0
CYIPBLOCK_S8_GPIO_VERSION EQU 2
CYDEV_BOOTLOADER_ENABLE EQU 0
    ENDIF
    END
