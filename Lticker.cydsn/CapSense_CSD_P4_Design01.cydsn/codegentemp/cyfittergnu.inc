.ifndef INCLUDED_CYFITTERGNU_INC
.set INCLUDED_CYFITTERGNU_INC, 1
.include "cydevicegnu_trm.inc"

/* LED_RED */
.set LED_RED__0__DM__MASK, 0x1C0000
.set LED_RED__0__DM__SHIFT, 18
.set LED_RED__0__DR, CYREG_PRT1_DR
.set LED_RED__0__HSIOM, CYREG_HSIOM_PORT_SEL1
.set LED_RED__0__HSIOM_MASK, 0x0F000000
.set LED_RED__0__HSIOM_SHIFT, 24
.set LED_RED__0__INTCFG, CYREG_PRT1_INTCFG
.set LED_RED__0__INTSTAT, CYREG_PRT1_INTSTAT
.set LED_RED__0__MASK, 0x40
.set LED_RED__0__OUT_SEL, CYREG_UDB_PA1_CFG10
.set LED_RED__0__OUT_SEL_SHIFT, 12
.set LED_RED__0__OUT_SEL_VAL, 2
.set LED_RED__0__PA__CFG0, CYREG_UDB_PA1_CFG0
.set LED_RED__0__PA__CFG1, CYREG_UDB_PA1_CFG1
.set LED_RED__0__PA__CFG10, CYREG_UDB_PA1_CFG10
.set LED_RED__0__PA__CFG11, CYREG_UDB_PA1_CFG11
.set LED_RED__0__PA__CFG12, CYREG_UDB_PA1_CFG12
.set LED_RED__0__PA__CFG13, CYREG_UDB_PA1_CFG13
.set LED_RED__0__PA__CFG14, CYREG_UDB_PA1_CFG14
.set LED_RED__0__PA__CFG2, CYREG_UDB_PA1_CFG2
.set LED_RED__0__PA__CFG3, CYREG_UDB_PA1_CFG3
.set LED_RED__0__PA__CFG4, CYREG_UDB_PA1_CFG4
.set LED_RED__0__PA__CFG5, CYREG_UDB_PA1_CFG5
.set LED_RED__0__PA__CFG6, CYREG_UDB_PA1_CFG6
.set LED_RED__0__PA__CFG7, CYREG_UDB_PA1_CFG7
.set LED_RED__0__PA__CFG8, CYREG_UDB_PA1_CFG8
.set LED_RED__0__PA__CFG9, CYREG_UDB_PA1_CFG9
.set LED_RED__0__PC, CYREG_PRT1_PC
.set LED_RED__0__PC2, CYREG_PRT1_PC2
.set LED_RED__0__PORT, 1
.set LED_RED__0__PS, CYREG_PRT1_PS
.set LED_RED__0__SHIFT, 6
.set LED_RED__DR, CYREG_PRT1_DR
.set LED_RED__INTCFG, CYREG_PRT1_INTCFG
.set LED_RED__INTSTAT, CYREG_PRT1_INTSTAT
.set LED_RED__MASK, 0x40
.set LED_RED__PA__CFG0, CYREG_UDB_PA1_CFG0
.set LED_RED__PA__CFG1, CYREG_UDB_PA1_CFG1
.set LED_RED__PA__CFG10, CYREG_UDB_PA1_CFG10
.set LED_RED__PA__CFG11, CYREG_UDB_PA1_CFG11
.set LED_RED__PA__CFG12, CYREG_UDB_PA1_CFG12
.set LED_RED__PA__CFG13, CYREG_UDB_PA1_CFG13
.set LED_RED__PA__CFG14, CYREG_UDB_PA1_CFG14
.set LED_RED__PA__CFG2, CYREG_UDB_PA1_CFG2
.set LED_RED__PA__CFG3, CYREG_UDB_PA1_CFG3
.set LED_RED__PA__CFG4, CYREG_UDB_PA1_CFG4
.set LED_RED__PA__CFG5, CYREG_UDB_PA1_CFG5
.set LED_RED__PA__CFG6, CYREG_UDB_PA1_CFG6
.set LED_RED__PA__CFG7, CYREG_UDB_PA1_CFG7
.set LED_RED__PA__CFG8, CYREG_UDB_PA1_CFG8
.set LED_RED__PA__CFG9, CYREG_UDB_PA1_CFG9
.set LED_RED__PC, CYREG_PRT1_PC
.set LED_RED__PC2, CYREG_PRT1_PC2
.set LED_RED__PORT, 1
.set LED_RED__PS, CYREG_PRT1_PS
.set LED_RED__SHIFT, 6

/* Clock_PWM */
.set Clock_PWM__DIVIDER_MASK, 0x0000FFFF
.set Clock_PWM__ENABLE, CYREG_CLK_DIVIDER_C00
.set Clock_PWM__ENABLE_MASK, 0x80000000
.set Clock_PWM__MASK, 0x80000000
.set Clock_PWM__REGISTER, CYREG_CLK_DIVIDER_C00

/* LED_GREEN */
.set LED_GREEN__0__DM__MASK, 0x1C0
.set LED_GREEN__0__DM__SHIFT, 6
.set LED_GREEN__0__DR, CYREG_PRT0_DR
.set LED_GREEN__0__HSIOM, CYREG_HSIOM_PORT_SEL0
.set LED_GREEN__0__HSIOM_MASK, 0x00000F00
.set LED_GREEN__0__HSIOM_SHIFT, 8
.set LED_GREEN__0__INTCFG, CYREG_PRT0_INTCFG
.set LED_GREEN__0__INTSTAT, CYREG_PRT0_INTSTAT
.set LED_GREEN__0__MASK, 0x04
.set LED_GREEN__0__OUT_SEL, CYREG_UDB_PA0_CFG10
.set LED_GREEN__0__OUT_SEL_SHIFT, 4
.set LED_GREEN__0__OUT_SEL_VAL, 0
.set LED_GREEN__0__PA__CFG0, CYREG_UDB_PA0_CFG0
.set LED_GREEN__0__PA__CFG1, CYREG_UDB_PA0_CFG1
.set LED_GREEN__0__PA__CFG10, CYREG_UDB_PA0_CFG10
.set LED_GREEN__0__PA__CFG11, CYREG_UDB_PA0_CFG11
.set LED_GREEN__0__PA__CFG12, CYREG_UDB_PA0_CFG12
.set LED_GREEN__0__PA__CFG13, CYREG_UDB_PA0_CFG13
.set LED_GREEN__0__PA__CFG14, CYREG_UDB_PA0_CFG14
.set LED_GREEN__0__PA__CFG2, CYREG_UDB_PA0_CFG2
.set LED_GREEN__0__PA__CFG3, CYREG_UDB_PA0_CFG3
.set LED_GREEN__0__PA__CFG4, CYREG_UDB_PA0_CFG4
.set LED_GREEN__0__PA__CFG5, CYREG_UDB_PA0_CFG5
.set LED_GREEN__0__PA__CFG6, CYREG_UDB_PA0_CFG6
.set LED_GREEN__0__PA__CFG7, CYREG_UDB_PA0_CFG7
.set LED_GREEN__0__PA__CFG8, CYREG_UDB_PA0_CFG8
.set LED_GREEN__0__PA__CFG9, CYREG_UDB_PA0_CFG9
.set LED_GREEN__0__PC, CYREG_PRT0_PC
.set LED_GREEN__0__PC2, CYREG_PRT0_PC2
.set LED_GREEN__0__PORT, 0
.set LED_GREEN__0__PS, CYREG_PRT0_PS
.set LED_GREEN__0__SHIFT, 2
.set LED_GREEN__DR, CYREG_PRT0_DR
.set LED_GREEN__INTCFG, CYREG_PRT0_INTCFG
.set LED_GREEN__INTSTAT, CYREG_PRT0_INTSTAT
.set LED_GREEN__MASK, 0x04
.set LED_GREEN__PA__CFG0, CYREG_UDB_PA0_CFG0
.set LED_GREEN__PA__CFG1, CYREG_UDB_PA0_CFG1
.set LED_GREEN__PA__CFG10, CYREG_UDB_PA0_CFG10
.set LED_GREEN__PA__CFG11, CYREG_UDB_PA0_CFG11
.set LED_GREEN__PA__CFG12, CYREG_UDB_PA0_CFG12
.set LED_GREEN__PA__CFG13, CYREG_UDB_PA0_CFG13
.set LED_GREEN__PA__CFG14, CYREG_UDB_PA0_CFG14
.set LED_GREEN__PA__CFG2, CYREG_UDB_PA0_CFG2
.set LED_GREEN__PA__CFG3, CYREG_UDB_PA0_CFG3
.set LED_GREEN__PA__CFG4, CYREG_UDB_PA0_CFG4
.set LED_GREEN__PA__CFG5, CYREG_UDB_PA0_CFG5
.set LED_GREEN__PA__CFG6, CYREG_UDB_PA0_CFG6
.set LED_GREEN__PA__CFG7, CYREG_UDB_PA0_CFG7
.set LED_GREEN__PA__CFG8, CYREG_UDB_PA0_CFG8
.set LED_GREEN__PA__CFG9, CYREG_UDB_PA0_CFG9
.set LED_GREEN__PC, CYREG_PRT0_PC
.set LED_GREEN__PC2, CYREG_PRT0_PC2
.set LED_GREEN__PORT, 0
.set LED_GREEN__PS, CYREG_PRT0_PS
.set LED_GREEN__SHIFT, 2

/* LED_CONTROL_cy_m0s8_tcpwm_1 */
.set LED_CONTROL_cy_m0s8_tcpwm_1__CC, CYREG_TCPWM_CNT0_CC
.set LED_CONTROL_cy_m0s8_tcpwm_1__CC_BUFF, CYREG_TCPWM_CNT0_CC_BUFF
.set LED_CONTROL_cy_m0s8_tcpwm_1__COUNTER, CYREG_TCPWM_CNT0_COUNTER
.set LED_CONTROL_cy_m0s8_tcpwm_1__CTRL, CYREG_TCPWM_CNT0_CTRL
.set LED_CONTROL_cy_m0s8_tcpwm_1__INTR, CYREG_TCPWM_CNT0_INTR
.set LED_CONTROL_cy_m0s8_tcpwm_1__INTR_MASK, CYREG_TCPWM_CNT0_INTR_MASK
.set LED_CONTROL_cy_m0s8_tcpwm_1__INTR_MASKED, CYREG_TCPWM_CNT0_INTR_MASKED
.set LED_CONTROL_cy_m0s8_tcpwm_1__INTR_SET, CYREG_TCPWM_CNT0_INTR_SET
.set LED_CONTROL_cy_m0s8_tcpwm_1__PERIOD, CYREG_TCPWM_CNT0_PERIOD
.set LED_CONTROL_cy_m0s8_tcpwm_1__PERIOD_BUFF, CYREG_TCPWM_CNT0_PERIOD_BUFF
.set LED_CONTROL_cy_m0s8_tcpwm_1__STATUS, CYREG_TCPWM_CNT0_STATUS
.set LED_CONTROL_cy_m0s8_tcpwm_1__TCPWM_CMD, CYREG_TCPWM_CMD
.set LED_CONTROL_cy_m0s8_tcpwm_1__TCPWM_CMDCAPTURE_MASK, 0x01
.set LED_CONTROL_cy_m0s8_tcpwm_1__TCPWM_CMDCAPTURE_SHIFT, 0
.set LED_CONTROL_cy_m0s8_tcpwm_1__TCPWM_CMDRELOAD_MASK, 0x100
.set LED_CONTROL_cy_m0s8_tcpwm_1__TCPWM_CMDRELOAD_SHIFT, 8
.set LED_CONTROL_cy_m0s8_tcpwm_1__TCPWM_CMDSTART_MASK, 0x1000000
.set LED_CONTROL_cy_m0s8_tcpwm_1__TCPWM_CMDSTART_SHIFT, 24
.set LED_CONTROL_cy_m0s8_tcpwm_1__TCPWM_CMDSTOP_MASK, 0x10000
.set LED_CONTROL_cy_m0s8_tcpwm_1__TCPWM_CMDSTOP_SHIFT, 16
.set LED_CONTROL_cy_m0s8_tcpwm_1__TCPWM_CTRL, CYREG_TCPWM_CTRL
.set LED_CONTROL_cy_m0s8_tcpwm_1__TCPWM_CTRL_MASK, 0x01
.set LED_CONTROL_cy_m0s8_tcpwm_1__TCPWM_CTRL_SHIFT, 0
.set LED_CONTROL_cy_m0s8_tcpwm_1__TCPWM_INTR_CAUSE, CYREG_TCPWM_INTR_CAUSE
.set LED_CONTROL_cy_m0s8_tcpwm_1__TCPWM_INTR_CAUSE_MASK, 0x01
.set LED_CONTROL_cy_m0s8_tcpwm_1__TCPWM_INTR_CAUSE_SHIFT, 0
.set LED_CONTROL_cy_m0s8_tcpwm_1__TCPWM_NUMBER, 0
.set LED_CONTROL_cy_m0s8_tcpwm_1__TR_CTRL0, CYREG_TCPWM_CNT0_TR_CTRL0
.set LED_CONTROL_cy_m0s8_tcpwm_1__TR_CTRL1, CYREG_TCPWM_CNT0_TR_CTRL1
.set LED_CONTROL_cy_m0s8_tcpwm_1__TR_CTRL2, CYREG_TCPWM_CNT0_TR_CTRL2

/* CapSense_CSD_Cmod */
.set CapSense_CSD_Cmod__0__DM__MASK, 0x1C0
.set CapSense_CSD_Cmod__0__DM__SHIFT, 6
.set CapSense_CSD_Cmod__0__DR, CYREG_PRT4_DR
.set CapSense_CSD_Cmod__0__HSIOM, CYREG_HSIOM_PORT_SEL4
.set CapSense_CSD_Cmod__0__HSIOM_MASK, 0x00000F00
.set CapSense_CSD_Cmod__0__HSIOM_SHIFT, 8
.set CapSense_CSD_Cmod__0__INTCFG, CYREG_PRT4_INTCFG
.set CapSense_CSD_Cmod__0__INTSTAT, CYREG_PRT4_INTSTAT
.set CapSense_CSD_Cmod__0__MASK, 0x04
.set CapSense_CSD_Cmod__0__PC, CYREG_PRT4_PC
.set CapSense_CSD_Cmod__0__PC2, CYREG_PRT4_PC2
.set CapSense_CSD_Cmod__0__PORT, 4
.set CapSense_CSD_Cmod__0__PS, CYREG_PRT4_PS
.set CapSense_CSD_Cmod__0__SHIFT, 2
.set CapSense_CSD_Cmod__Cmod__DM__MASK, 0x1C0
.set CapSense_CSD_Cmod__Cmod__DM__SHIFT, 6
.set CapSense_CSD_Cmod__Cmod__DR, CYREG_PRT4_DR
.set CapSense_CSD_Cmod__Cmod__INTCFG, CYREG_PRT4_INTCFG
.set CapSense_CSD_Cmod__Cmod__INTSTAT, CYREG_PRT4_INTSTAT
.set CapSense_CSD_Cmod__Cmod__MASK, 0x04
.set CapSense_CSD_Cmod__Cmod__PC, CYREG_PRT4_PC
.set CapSense_CSD_Cmod__Cmod__PC2, CYREG_PRT4_PC2
.set CapSense_CSD_Cmod__Cmod__PORT, 4
.set CapSense_CSD_Cmod__Cmod__PS, CYREG_PRT4_PS
.set CapSense_CSD_Cmod__Cmod__SHIFT, 2
.set CapSense_CSD_Cmod__DR, CYREG_PRT4_DR
.set CapSense_CSD_Cmod__INTCFG, CYREG_PRT4_INTCFG
.set CapSense_CSD_Cmod__INTSTAT, CYREG_PRT4_INTSTAT
.set CapSense_CSD_Cmod__MASK, 0x04
.set CapSense_CSD_Cmod__PC, CYREG_PRT4_PC
.set CapSense_CSD_Cmod__PC2, CYREG_PRT4_PC2
.set CapSense_CSD_Cmod__PORT, 4
.set CapSense_CSD_Cmod__PS, CYREG_PRT4_PS
.set CapSense_CSD_Cmod__SHIFT, 2

/* CapSense_CSD_CSD_FFB */
.set CapSense_CSD_CSD_FFB__CSD_CONFIG, CYREG_CSD_CONFIG
.set CapSense_CSD_CSD_FFB__CSD_COUNTER, CYREG_CSD_COUNTER
.set CapSense_CSD_CSD_FFB__CSD_ID, CYREG_CSD_ID
.set CapSense_CSD_CSD_FFB__CSD_INTR, CYREG_CSD_INTR
.set CapSense_CSD_CSD_FFB__CSD_INTR_SET, CYREG_CSD_INTR_SET
.set CapSense_CSD_CSD_FFB__CSD_NUMBER, 0
.set CapSense_CSD_CSD_FFB__CSD_STATUS, CYREG_CSD_STATUS

/* CapSense_CSD_IDAC1_cy_psoc4_idac */
.set CapSense_CSD_IDAC1_cy_psoc4_idac__CSD_IDAC, CYREG_CSD_IDAC
.set CapSense_CSD_IDAC1_cy_psoc4_idac__CSD_IDAC_SHIFT, 0
.set CapSense_CSD_IDAC1_cy_psoc4_idac__CSD_TRIM1, CYREG_CSD_TRIM1
.set CapSense_CSD_IDAC1_cy_psoc4_idac__CSD_TRIM1_SHIFT, 0
.set CapSense_CSD_IDAC1_cy_psoc4_idac__CSD_TRIM2, CYREG_CSD_TRIM2
.set CapSense_CSD_IDAC1_cy_psoc4_idac__CSD_TRIM2_SHIFT, 0
.set CapSense_CSD_IDAC1_cy_psoc4_idac__IDAC_NUMBER, 1
.set CapSense_CSD_IDAC1_cy_psoc4_idac__POLARITY, CYREG_CSD_CONFIG
.set CapSense_CSD_IDAC1_cy_psoc4_idac__POLARITY_SHIFT, 16

/* CapSense_CSD_IDAC2_cy_psoc4_idac */
.set CapSense_CSD_IDAC2_cy_psoc4_idac__CSD_IDAC, CYREG_CSD_IDAC
.set CapSense_CSD_IDAC2_cy_psoc4_idac__CSD_IDAC_SHIFT, 16
.set CapSense_CSD_IDAC2_cy_psoc4_idac__CSD_TRIM1, CYREG_CSD_TRIM1
.set CapSense_CSD_IDAC2_cy_psoc4_idac__CSD_TRIM1_SHIFT, 4
.set CapSense_CSD_IDAC2_cy_psoc4_idac__CSD_TRIM2, CYREG_CSD_TRIM2
.set CapSense_CSD_IDAC2_cy_psoc4_idac__CSD_TRIM2_SHIFT, 4
.set CapSense_CSD_IDAC2_cy_psoc4_idac__IDAC_NUMBER, 2
.set CapSense_CSD_IDAC2_cy_psoc4_idac__POLARITY, CYREG_CSD_CONFIG
.set CapSense_CSD_IDAC2_cy_psoc4_idac__POLARITY_SHIFT, 17

/* CapSense_CSD_ISR */
.set CapSense_CSD_ISR__INTC_CLR_EN_REG, CYREG_CM0_ICER
.set CapSense_CSD_ISR__INTC_CLR_PD_REG, CYREG_CM0_ICPR
.set CapSense_CSD_ISR__INTC_MASK, 0x8000
.set CapSense_CSD_ISR__INTC_NUMBER, 15
.set CapSense_CSD_ISR__INTC_PRIOR_MASK, 0xC0000000
.set CapSense_CSD_ISR__INTC_PRIOR_NUM, 3
.set CapSense_CSD_ISR__INTC_PRIOR_REG, CYREG_CM0_IPR3
.set CapSense_CSD_ISR__INTC_SET_EN_REG, CYREG_CM0_ISER
.set CapSense_CSD_ISR__INTC_SET_PD_REG, CYREG_CM0_ISPR

/* CapSense_CSD_SampleClk */
.set CapSense_CSD_SampleClk__DIVIDER_MASK, 0x0000FFFF
.set CapSense_CSD_SampleClk__ENABLE, CYREG_CLK_DIVIDER_A00
.set CapSense_CSD_SampleClk__ENABLE_MASK, 0x80000000
.set CapSense_CSD_SampleClk__MASK, 0x80000000
.set CapSense_CSD_SampleClk__REGISTER, CYREG_CLK_DIVIDER_A00

/* CapSense_CSD_SenseClk */
.set CapSense_CSD_SenseClk__DIVIDER_MASK, 0x0000FFFF
.set CapSense_CSD_SenseClk__ENABLE, CYREG_CLK_DIVIDER_B00
.set CapSense_CSD_SenseClk__ENABLE_MASK, 0x80000000
.set CapSense_CSD_SenseClk__MASK, 0x80000000
.set CapSense_CSD_SenseClk__REGISTER, CYREG_CLK_DIVIDER_B00

/* CapSense_CSD_Sns */
.set CapSense_CSD_Sns__0__DM__MASK, 0x38
.set CapSense_CSD_Sns__0__DM__SHIFT, 3
.set CapSense_CSD_Sns__0__DR, CYREG_PRT1_DR
.set CapSense_CSD_Sns__0__HSIOM, CYREG_HSIOM_PORT_SEL1
.set CapSense_CSD_Sns__0__HSIOM_MASK, 0x000000F0
.set CapSense_CSD_Sns__0__HSIOM_SHIFT, 4
.set CapSense_CSD_Sns__0__INTCFG, CYREG_PRT1_INTCFG
.set CapSense_CSD_Sns__0__INTSTAT, CYREG_PRT1_INTSTAT
.set CapSense_CSD_Sns__0__MASK, 0x02
.set CapSense_CSD_Sns__0__PA__CFG0, CYREG_UDB_PA1_CFG0
.set CapSense_CSD_Sns__0__PA__CFG1, CYREG_UDB_PA1_CFG1
.set CapSense_CSD_Sns__0__PA__CFG10, CYREG_UDB_PA1_CFG10
.set CapSense_CSD_Sns__0__PA__CFG11, CYREG_UDB_PA1_CFG11
.set CapSense_CSD_Sns__0__PA__CFG12, CYREG_UDB_PA1_CFG12
.set CapSense_CSD_Sns__0__PA__CFG13, CYREG_UDB_PA1_CFG13
.set CapSense_CSD_Sns__0__PA__CFG14, CYREG_UDB_PA1_CFG14
.set CapSense_CSD_Sns__0__PA__CFG2, CYREG_UDB_PA1_CFG2
.set CapSense_CSD_Sns__0__PA__CFG3, CYREG_UDB_PA1_CFG3
.set CapSense_CSD_Sns__0__PA__CFG4, CYREG_UDB_PA1_CFG4
.set CapSense_CSD_Sns__0__PA__CFG5, CYREG_UDB_PA1_CFG5
.set CapSense_CSD_Sns__0__PA__CFG6, CYREG_UDB_PA1_CFG6
.set CapSense_CSD_Sns__0__PA__CFG7, CYREG_UDB_PA1_CFG7
.set CapSense_CSD_Sns__0__PA__CFG8, CYREG_UDB_PA1_CFG8
.set CapSense_CSD_Sns__0__PA__CFG9, CYREG_UDB_PA1_CFG9
.set CapSense_CSD_Sns__0__PC, CYREG_PRT1_PC
.set CapSense_CSD_Sns__0__PC2, CYREG_PRT1_PC2
.set CapSense_CSD_Sns__0__PORT, 1
.set CapSense_CSD_Sns__0__PS, CYREG_PRT1_PS
.set CapSense_CSD_Sns__0__SHIFT, 1
.set CapSense_CSD_Sns__1__DM__MASK, 0x1C0
.set CapSense_CSD_Sns__1__DM__SHIFT, 6
.set CapSense_CSD_Sns__1__DR, CYREG_PRT1_DR
.set CapSense_CSD_Sns__1__HSIOM, CYREG_HSIOM_PORT_SEL1
.set CapSense_CSD_Sns__1__HSIOM_MASK, 0x00000F00
.set CapSense_CSD_Sns__1__HSIOM_SHIFT, 8
.set CapSense_CSD_Sns__1__INTCFG, CYREG_PRT1_INTCFG
.set CapSense_CSD_Sns__1__INTSTAT, CYREG_PRT1_INTSTAT
.set CapSense_CSD_Sns__1__MASK, 0x04
.set CapSense_CSD_Sns__1__PA__CFG0, CYREG_UDB_PA1_CFG0
.set CapSense_CSD_Sns__1__PA__CFG1, CYREG_UDB_PA1_CFG1
.set CapSense_CSD_Sns__1__PA__CFG10, CYREG_UDB_PA1_CFG10
.set CapSense_CSD_Sns__1__PA__CFG11, CYREG_UDB_PA1_CFG11
.set CapSense_CSD_Sns__1__PA__CFG12, CYREG_UDB_PA1_CFG12
.set CapSense_CSD_Sns__1__PA__CFG13, CYREG_UDB_PA1_CFG13
.set CapSense_CSD_Sns__1__PA__CFG14, CYREG_UDB_PA1_CFG14
.set CapSense_CSD_Sns__1__PA__CFG2, CYREG_UDB_PA1_CFG2
.set CapSense_CSD_Sns__1__PA__CFG3, CYREG_UDB_PA1_CFG3
.set CapSense_CSD_Sns__1__PA__CFG4, CYREG_UDB_PA1_CFG4
.set CapSense_CSD_Sns__1__PA__CFG5, CYREG_UDB_PA1_CFG5
.set CapSense_CSD_Sns__1__PA__CFG6, CYREG_UDB_PA1_CFG6
.set CapSense_CSD_Sns__1__PA__CFG7, CYREG_UDB_PA1_CFG7
.set CapSense_CSD_Sns__1__PA__CFG8, CYREG_UDB_PA1_CFG8
.set CapSense_CSD_Sns__1__PA__CFG9, CYREG_UDB_PA1_CFG9
.set CapSense_CSD_Sns__1__PC, CYREG_PRT1_PC
.set CapSense_CSD_Sns__1__PC2, CYREG_PRT1_PC2
.set CapSense_CSD_Sns__1__PORT, 1
.set CapSense_CSD_Sns__1__PS, CYREG_PRT1_PS
.set CapSense_CSD_Sns__1__SHIFT, 2
.set CapSense_CSD_Sns__2__DM__MASK, 0xE00
.set CapSense_CSD_Sns__2__DM__SHIFT, 9
.set CapSense_CSD_Sns__2__DR, CYREG_PRT1_DR
.set CapSense_CSD_Sns__2__HSIOM, CYREG_HSIOM_PORT_SEL1
.set CapSense_CSD_Sns__2__HSIOM_MASK, 0x0000F000
.set CapSense_CSD_Sns__2__HSIOM_SHIFT, 12
.set CapSense_CSD_Sns__2__INTCFG, CYREG_PRT1_INTCFG
.set CapSense_CSD_Sns__2__INTSTAT, CYREG_PRT1_INTSTAT
.set CapSense_CSD_Sns__2__MASK, 0x08
.set CapSense_CSD_Sns__2__PA__CFG0, CYREG_UDB_PA1_CFG0
.set CapSense_CSD_Sns__2__PA__CFG1, CYREG_UDB_PA1_CFG1
.set CapSense_CSD_Sns__2__PA__CFG10, CYREG_UDB_PA1_CFG10
.set CapSense_CSD_Sns__2__PA__CFG11, CYREG_UDB_PA1_CFG11
.set CapSense_CSD_Sns__2__PA__CFG12, CYREG_UDB_PA1_CFG12
.set CapSense_CSD_Sns__2__PA__CFG13, CYREG_UDB_PA1_CFG13
.set CapSense_CSD_Sns__2__PA__CFG14, CYREG_UDB_PA1_CFG14
.set CapSense_CSD_Sns__2__PA__CFG2, CYREG_UDB_PA1_CFG2
.set CapSense_CSD_Sns__2__PA__CFG3, CYREG_UDB_PA1_CFG3
.set CapSense_CSD_Sns__2__PA__CFG4, CYREG_UDB_PA1_CFG4
.set CapSense_CSD_Sns__2__PA__CFG5, CYREG_UDB_PA1_CFG5
.set CapSense_CSD_Sns__2__PA__CFG6, CYREG_UDB_PA1_CFG6
.set CapSense_CSD_Sns__2__PA__CFG7, CYREG_UDB_PA1_CFG7
.set CapSense_CSD_Sns__2__PA__CFG8, CYREG_UDB_PA1_CFG8
.set CapSense_CSD_Sns__2__PA__CFG9, CYREG_UDB_PA1_CFG9
.set CapSense_CSD_Sns__2__PC, CYREG_PRT1_PC
.set CapSense_CSD_Sns__2__PC2, CYREG_PRT1_PC2
.set CapSense_CSD_Sns__2__PORT, 1
.set CapSense_CSD_Sns__2__PS, CYREG_PRT1_PS
.set CapSense_CSD_Sns__2__SHIFT, 3
.set CapSense_CSD_Sns__3__DM__MASK, 0x7000
.set CapSense_CSD_Sns__3__DM__SHIFT, 12
.set CapSense_CSD_Sns__3__DR, CYREG_PRT1_DR
.set CapSense_CSD_Sns__3__HSIOM, CYREG_HSIOM_PORT_SEL1
.set CapSense_CSD_Sns__3__HSIOM_MASK, 0x000F0000
.set CapSense_CSD_Sns__3__HSIOM_SHIFT, 16
.set CapSense_CSD_Sns__3__INTCFG, CYREG_PRT1_INTCFG
.set CapSense_CSD_Sns__3__INTSTAT, CYREG_PRT1_INTSTAT
.set CapSense_CSD_Sns__3__MASK, 0x10
.set CapSense_CSD_Sns__3__PA__CFG0, CYREG_UDB_PA1_CFG0
.set CapSense_CSD_Sns__3__PA__CFG1, CYREG_UDB_PA1_CFG1
.set CapSense_CSD_Sns__3__PA__CFG10, CYREG_UDB_PA1_CFG10
.set CapSense_CSD_Sns__3__PA__CFG11, CYREG_UDB_PA1_CFG11
.set CapSense_CSD_Sns__3__PA__CFG12, CYREG_UDB_PA1_CFG12
.set CapSense_CSD_Sns__3__PA__CFG13, CYREG_UDB_PA1_CFG13
.set CapSense_CSD_Sns__3__PA__CFG14, CYREG_UDB_PA1_CFG14
.set CapSense_CSD_Sns__3__PA__CFG2, CYREG_UDB_PA1_CFG2
.set CapSense_CSD_Sns__3__PA__CFG3, CYREG_UDB_PA1_CFG3
.set CapSense_CSD_Sns__3__PA__CFG4, CYREG_UDB_PA1_CFG4
.set CapSense_CSD_Sns__3__PA__CFG5, CYREG_UDB_PA1_CFG5
.set CapSense_CSD_Sns__3__PA__CFG6, CYREG_UDB_PA1_CFG6
.set CapSense_CSD_Sns__3__PA__CFG7, CYREG_UDB_PA1_CFG7
.set CapSense_CSD_Sns__3__PA__CFG8, CYREG_UDB_PA1_CFG8
.set CapSense_CSD_Sns__3__PA__CFG9, CYREG_UDB_PA1_CFG9
.set CapSense_CSD_Sns__3__PC, CYREG_PRT1_PC
.set CapSense_CSD_Sns__3__PC2, CYREG_PRT1_PC2
.set CapSense_CSD_Sns__3__PORT, 1
.set CapSense_CSD_Sns__3__PS, CYREG_PRT1_PS
.set CapSense_CSD_Sns__3__SHIFT, 4
.set CapSense_CSD_Sns__4__DM__MASK, 0x38000
.set CapSense_CSD_Sns__4__DM__SHIFT, 15
.set CapSense_CSD_Sns__4__DR, CYREG_PRT1_DR
.set CapSense_CSD_Sns__4__HSIOM, CYREG_HSIOM_PORT_SEL1
.set CapSense_CSD_Sns__4__HSIOM_MASK, 0x00F00000
.set CapSense_CSD_Sns__4__HSIOM_SHIFT, 20
.set CapSense_CSD_Sns__4__INTCFG, CYREG_PRT1_INTCFG
.set CapSense_CSD_Sns__4__INTSTAT, CYREG_PRT1_INTSTAT
.set CapSense_CSD_Sns__4__MASK, 0x20
.set CapSense_CSD_Sns__4__PA__CFG0, CYREG_UDB_PA1_CFG0
.set CapSense_CSD_Sns__4__PA__CFG1, CYREG_UDB_PA1_CFG1
.set CapSense_CSD_Sns__4__PA__CFG10, CYREG_UDB_PA1_CFG10
.set CapSense_CSD_Sns__4__PA__CFG11, CYREG_UDB_PA1_CFG11
.set CapSense_CSD_Sns__4__PA__CFG12, CYREG_UDB_PA1_CFG12
.set CapSense_CSD_Sns__4__PA__CFG13, CYREG_UDB_PA1_CFG13
.set CapSense_CSD_Sns__4__PA__CFG14, CYREG_UDB_PA1_CFG14
.set CapSense_CSD_Sns__4__PA__CFG2, CYREG_UDB_PA1_CFG2
.set CapSense_CSD_Sns__4__PA__CFG3, CYREG_UDB_PA1_CFG3
.set CapSense_CSD_Sns__4__PA__CFG4, CYREG_UDB_PA1_CFG4
.set CapSense_CSD_Sns__4__PA__CFG5, CYREG_UDB_PA1_CFG5
.set CapSense_CSD_Sns__4__PA__CFG6, CYREG_UDB_PA1_CFG6
.set CapSense_CSD_Sns__4__PA__CFG7, CYREG_UDB_PA1_CFG7
.set CapSense_CSD_Sns__4__PA__CFG8, CYREG_UDB_PA1_CFG8
.set CapSense_CSD_Sns__4__PA__CFG9, CYREG_UDB_PA1_CFG9
.set CapSense_CSD_Sns__4__PC, CYREG_PRT1_PC
.set CapSense_CSD_Sns__4__PC2, CYREG_PRT1_PC2
.set CapSense_CSD_Sns__4__PORT, 1
.set CapSense_CSD_Sns__4__PS, CYREG_PRT1_PS
.set CapSense_CSD_Sns__4__SHIFT, 5
.set CapSense_CSD_Sns__DR, CYREG_PRT1_DR
.set CapSense_CSD_Sns__INTCFG, CYREG_PRT1_INTCFG
.set CapSense_CSD_Sns__INTSTAT, CYREG_PRT1_INTSTAT
.set CapSense_CSD_Sns__LinearSlider0_e0__LS__DM__MASK, 0x38
.set CapSense_CSD_Sns__LinearSlider0_e0__LS__DM__SHIFT, 3
.set CapSense_CSD_Sns__LinearSlider0_e0__LS__DR, CYREG_PRT1_DR
.set CapSense_CSD_Sns__LinearSlider0_e0__LS__INTCFG, CYREG_PRT1_INTCFG
.set CapSense_CSD_Sns__LinearSlider0_e0__LS__INTSTAT, CYREG_PRT1_INTSTAT
.set CapSense_CSD_Sns__LinearSlider0_e0__LS__MASK, 0x02
.set CapSense_CSD_Sns__LinearSlider0_e0__LS__PA__CFG0, CYREG_UDB_PA1_CFG0
.set CapSense_CSD_Sns__LinearSlider0_e0__LS__PA__CFG1, CYREG_UDB_PA1_CFG1
.set CapSense_CSD_Sns__LinearSlider0_e0__LS__PA__CFG10, CYREG_UDB_PA1_CFG10
.set CapSense_CSD_Sns__LinearSlider0_e0__LS__PA__CFG11, CYREG_UDB_PA1_CFG11
.set CapSense_CSD_Sns__LinearSlider0_e0__LS__PA__CFG12, CYREG_UDB_PA1_CFG12
.set CapSense_CSD_Sns__LinearSlider0_e0__LS__PA__CFG13, CYREG_UDB_PA1_CFG13
.set CapSense_CSD_Sns__LinearSlider0_e0__LS__PA__CFG14, CYREG_UDB_PA1_CFG14
.set CapSense_CSD_Sns__LinearSlider0_e0__LS__PA__CFG2, CYREG_UDB_PA1_CFG2
.set CapSense_CSD_Sns__LinearSlider0_e0__LS__PA__CFG3, CYREG_UDB_PA1_CFG3
.set CapSense_CSD_Sns__LinearSlider0_e0__LS__PA__CFG4, CYREG_UDB_PA1_CFG4
.set CapSense_CSD_Sns__LinearSlider0_e0__LS__PA__CFG5, CYREG_UDB_PA1_CFG5
.set CapSense_CSD_Sns__LinearSlider0_e0__LS__PA__CFG6, CYREG_UDB_PA1_CFG6
.set CapSense_CSD_Sns__LinearSlider0_e0__LS__PA__CFG7, CYREG_UDB_PA1_CFG7
.set CapSense_CSD_Sns__LinearSlider0_e0__LS__PA__CFG8, CYREG_UDB_PA1_CFG8
.set CapSense_CSD_Sns__LinearSlider0_e0__LS__PA__CFG9, CYREG_UDB_PA1_CFG9
.set CapSense_CSD_Sns__LinearSlider0_e0__LS__PC, CYREG_PRT1_PC
.set CapSense_CSD_Sns__LinearSlider0_e0__LS__PC2, CYREG_PRT1_PC2
.set CapSense_CSD_Sns__LinearSlider0_e0__LS__PORT, 1
.set CapSense_CSD_Sns__LinearSlider0_e0__LS__PS, CYREG_PRT1_PS
.set CapSense_CSD_Sns__LinearSlider0_e0__LS__SHIFT, 1
.set CapSense_CSD_Sns__LinearSlider0_e1__LS__DM__MASK, 0x1C0
.set CapSense_CSD_Sns__LinearSlider0_e1__LS__DM__SHIFT, 6
.set CapSense_CSD_Sns__LinearSlider0_e1__LS__DR, CYREG_PRT1_DR
.set CapSense_CSD_Sns__LinearSlider0_e1__LS__INTCFG, CYREG_PRT1_INTCFG
.set CapSense_CSD_Sns__LinearSlider0_e1__LS__INTSTAT, CYREG_PRT1_INTSTAT
.set CapSense_CSD_Sns__LinearSlider0_e1__LS__MASK, 0x04
.set CapSense_CSD_Sns__LinearSlider0_e1__LS__PA__CFG0, CYREG_UDB_PA1_CFG0
.set CapSense_CSD_Sns__LinearSlider0_e1__LS__PA__CFG1, CYREG_UDB_PA1_CFG1
.set CapSense_CSD_Sns__LinearSlider0_e1__LS__PA__CFG10, CYREG_UDB_PA1_CFG10
.set CapSense_CSD_Sns__LinearSlider0_e1__LS__PA__CFG11, CYREG_UDB_PA1_CFG11
.set CapSense_CSD_Sns__LinearSlider0_e1__LS__PA__CFG12, CYREG_UDB_PA1_CFG12
.set CapSense_CSD_Sns__LinearSlider0_e1__LS__PA__CFG13, CYREG_UDB_PA1_CFG13
.set CapSense_CSD_Sns__LinearSlider0_e1__LS__PA__CFG14, CYREG_UDB_PA1_CFG14
.set CapSense_CSD_Sns__LinearSlider0_e1__LS__PA__CFG2, CYREG_UDB_PA1_CFG2
.set CapSense_CSD_Sns__LinearSlider0_e1__LS__PA__CFG3, CYREG_UDB_PA1_CFG3
.set CapSense_CSD_Sns__LinearSlider0_e1__LS__PA__CFG4, CYREG_UDB_PA1_CFG4
.set CapSense_CSD_Sns__LinearSlider0_e1__LS__PA__CFG5, CYREG_UDB_PA1_CFG5
.set CapSense_CSD_Sns__LinearSlider0_e1__LS__PA__CFG6, CYREG_UDB_PA1_CFG6
.set CapSense_CSD_Sns__LinearSlider0_e1__LS__PA__CFG7, CYREG_UDB_PA1_CFG7
.set CapSense_CSD_Sns__LinearSlider0_e1__LS__PA__CFG8, CYREG_UDB_PA1_CFG8
.set CapSense_CSD_Sns__LinearSlider0_e1__LS__PA__CFG9, CYREG_UDB_PA1_CFG9
.set CapSense_CSD_Sns__LinearSlider0_e1__LS__PC, CYREG_PRT1_PC
.set CapSense_CSD_Sns__LinearSlider0_e1__LS__PC2, CYREG_PRT1_PC2
.set CapSense_CSD_Sns__LinearSlider0_e1__LS__PORT, 1
.set CapSense_CSD_Sns__LinearSlider0_e1__LS__PS, CYREG_PRT1_PS
.set CapSense_CSD_Sns__LinearSlider0_e1__LS__SHIFT, 2
.set CapSense_CSD_Sns__LinearSlider0_e2__LS__DM__MASK, 0xE00
.set CapSense_CSD_Sns__LinearSlider0_e2__LS__DM__SHIFT, 9
.set CapSense_CSD_Sns__LinearSlider0_e2__LS__DR, CYREG_PRT1_DR
.set CapSense_CSD_Sns__LinearSlider0_e2__LS__INTCFG, CYREG_PRT1_INTCFG
.set CapSense_CSD_Sns__LinearSlider0_e2__LS__INTSTAT, CYREG_PRT1_INTSTAT
.set CapSense_CSD_Sns__LinearSlider0_e2__LS__MASK, 0x08
.set CapSense_CSD_Sns__LinearSlider0_e2__LS__PA__CFG0, CYREG_UDB_PA1_CFG0
.set CapSense_CSD_Sns__LinearSlider0_e2__LS__PA__CFG1, CYREG_UDB_PA1_CFG1
.set CapSense_CSD_Sns__LinearSlider0_e2__LS__PA__CFG10, CYREG_UDB_PA1_CFG10
.set CapSense_CSD_Sns__LinearSlider0_e2__LS__PA__CFG11, CYREG_UDB_PA1_CFG11
.set CapSense_CSD_Sns__LinearSlider0_e2__LS__PA__CFG12, CYREG_UDB_PA1_CFG12
.set CapSense_CSD_Sns__LinearSlider0_e2__LS__PA__CFG13, CYREG_UDB_PA1_CFG13
.set CapSense_CSD_Sns__LinearSlider0_e2__LS__PA__CFG14, CYREG_UDB_PA1_CFG14
.set CapSense_CSD_Sns__LinearSlider0_e2__LS__PA__CFG2, CYREG_UDB_PA1_CFG2
.set CapSense_CSD_Sns__LinearSlider0_e2__LS__PA__CFG3, CYREG_UDB_PA1_CFG3
.set CapSense_CSD_Sns__LinearSlider0_e2__LS__PA__CFG4, CYREG_UDB_PA1_CFG4
.set CapSense_CSD_Sns__LinearSlider0_e2__LS__PA__CFG5, CYREG_UDB_PA1_CFG5
.set CapSense_CSD_Sns__LinearSlider0_e2__LS__PA__CFG6, CYREG_UDB_PA1_CFG6
.set CapSense_CSD_Sns__LinearSlider0_e2__LS__PA__CFG7, CYREG_UDB_PA1_CFG7
.set CapSense_CSD_Sns__LinearSlider0_e2__LS__PA__CFG8, CYREG_UDB_PA1_CFG8
.set CapSense_CSD_Sns__LinearSlider0_e2__LS__PA__CFG9, CYREG_UDB_PA1_CFG9
.set CapSense_CSD_Sns__LinearSlider0_e2__LS__PC, CYREG_PRT1_PC
.set CapSense_CSD_Sns__LinearSlider0_e2__LS__PC2, CYREG_PRT1_PC2
.set CapSense_CSD_Sns__LinearSlider0_e2__LS__PORT, 1
.set CapSense_CSD_Sns__LinearSlider0_e2__LS__PS, CYREG_PRT1_PS
.set CapSense_CSD_Sns__LinearSlider0_e2__LS__SHIFT, 3
.set CapSense_CSD_Sns__LinearSlider0_e3__LS__DM__MASK, 0x7000
.set CapSense_CSD_Sns__LinearSlider0_e3__LS__DM__SHIFT, 12
.set CapSense_CSD_Sns__LinearSlider0_e3__LS__DR, CYREG_PRT1_DR
.set CapSense_CSD_Sns__LinearSlider0_e3__LS__INTCFG, CYREG_PRT1_INTCFG
.set CapSense_CSD_Sns__LinearSlider0_e3__LS__INTSTAT, CYREG_PRT1_INTSTAT
.set CapSense_CSD_Sns__LinearSlider0_e3__LS__MASK, 0x10
.set CapSense_CSD_Sns__LinearSlider0_e3__LS__PA__CFG0, CYREG_UDB_PA1_CFG0
.set CapSense_CSD_Sns__LinearSlider0_e3__LS__PA__CFG1, CYREG_UDB_PA1_CFG1
.set CapSense_CSD_Sns__LinearSlider0_e3__LS__PA__CFG10, CYREG_UDB_PA1_CFG10
.set CapSense_CSD_Sns__LinearSlider0_e3__LS__PA__CFG11, CYREG_UDB_PA1_CFG11
.set CapSense_CSD_Sns__LinearSlider0_e3__LS__PA__CFG12, CYREG_UDB_PA1_CFG12
.set CapSense_CSD_Sns__LinearSlider0_e3__LS__PA__CFG13, CYREG_UDB_PA1_CFG13
.set CapSense_CSD_Sns__LinearSlider0_e3__LS__PA__CFG14, CYREG_UDB_PA1_CFG14
.set CapSense_CSD_Sns__LinearSlider0_e3__LS__PA__CFG2, CYREG_UDB_PA1_CFG2
.set CapSense_CSD_Sns__LinearSlider0_e3__LS__PA__CFG3, CYREG_UDB_PA1_CFG3
.set CapSense_CSD_Sns__LinearSlider0_e3__LS__PA__CFG4, CYREG_UDB_PA1_CFG4
.set CapSense_CSD_Sns__LinearSlider0_e3__LS__PA__CFG5, CYREG_UDB_PA1_CFG5
.set CapSense_CSD_Sns__LinearSlider0_e3__LS__PA__CFG6, CYREG_UDB_PA1_CFG6
.set CapSense_CSD_Sns__LinearSlider0_e3__LS__PA__CFG7, CYREG_UDB_PA1_CFG7
.set CapSense_CSD_Sns__LinearSlider0_e3__LS__PA__CFG8, CYREG_UDB_PA1_CFG8
.set CapSense_CSD_Sns__LinearSlider0_e3__LS__PA__CFG9, CYREG_UDB_PA1_CFG9
.set CapSense_CSD_Sns__LinearSlider0_e3__LS__PC, CYREG_PRT1_PC
.set CapSense_CSD_Sns__LinearSlider0_e3__LS__PC2, CYREG_PRT1_PC2
.set CapSense_CSD_Sns__LinearSlider0_e3__LS__PORT, 1
.set CapSense_CSD_Sns__LinearSlider0_e3__LS__PS, CYREG_PRT1_PS
.set CapSense_CSD_Sns__LinearSlider0_e3__LS__SHIFT, 4
.set CapSense_CSD_Sns__LinearSlider0_e4__LS__DM__MASK, 0x38000
.set CapSense_CSD_Sns__LinearSlider0_e4__LS__DM__SHIFT, 15
.set CapSense_CSD_Sns__LinearSlider0_e4__LS__DR, CYREG_PRT1_DR
.set CapSense_CSD_Sns__LinearSlider0_e4__LS__INTCFG, CYREG_PRT1_INTCFG
.set CapSense_CSD_Sns__LinearSlider0_e4__LS__INTSTAT, CYREG_PRT1_INTSTAT
.set CapSense_CSD_Sns__LinearSlider0_e4__LS__MASK, 0x20
.set CapSense_CSD_Sns__LinearSlider0_e4__LS__PA__CFG0, CYREG_UDB_PA1_CFG0
.set CapSense_CSD_Sns__LinearSlider0_e4__LS__PA__CFG1, CYREG_UDB_PA1_CFG1
.set CapSense_CSD_Sns__LinearSlider0_e4__LS__PA__CFG10, CYREG_UDB_PA1_CFG10
.set CapSense_CSD_Sns__LinearSlider0_e4__LS__PA__CFG11, CYREG_UDB_PA1_CFG11
.set CapSense_CSD_Sns__LinearSlider0_e4__LS__PA__CFG12, CYREG_UDB_PA1_CFG12
.set CapSense_CSD_Sns__LinearSlider0_e4__LS__PA__CFG13, CYREG_UDB_PA1_CFG13
.set CapSense_CSD_Sns__LinearSlider0_e4__LS__PA__CFG14, CYREG_UDB_PA1_CFG14
.set CapSense_CSD_Sns__LinearSlider0_e4__LS__PA__CFG2, CYREG_UDB_PA1_CFG2
.set CapSense_CSD_Sns__LinearSlider0_e4__LS__PA__CFG3, CYREG_UDB_PA1_CFG3
.set CapSense_CSD_Sns__LinearSlider0_e4__LS__PA__CFG4, CYREG_UDB_PA1_CFG4
.set CapSense_CSD_Sns__LinearSlider0_e4__LS__PA__CFG5, CYREG_UDB_PA1_CFG5
.set CapSense_CSD_Sns__LinearSlider0_e4__LS__PA__CFG6, CYREG_UDB_PA1_CFG6
.set CapSense_CSD_Sns__LinearSlider0_e4__LS__PA__CFG7, CYREG_UDB_PA1_CFG7
.set CapSense_CSD_Sns__LinearSlider0_e4__LS__PA__CFG8, CYREG_UDB_PA1_CFG8
.set CapSense_CSD_Sns__LinearSlider0_e4__LS__PA__CFG9, CYREG_UDB_PA1_CFG9
.set CapSense_CSD_Sns__LinearSlider0_e4__LS__PC, CYREG_PRT1_PC
.set CapSense_CSD_Sns__LinearSlider0_e4__LS__PC2, CYREG_PRT1_PC2
.set CapSense_CSD_Sns__LinearSlider0_e4__LS__PORT, 1
.set CapSense_CSD_Sns__LinearSlider0_e4__LS__PS, CYREG_PRT1_PS
.set CapSense_CSD_Sns__LinearSlider0_e4__LS__SHIFT, 5
.set CapSense_CSD_Sns__PA__CFG0, CYREG_UDB_PA1_CFG0
.set CapSense_CSD_Sns__PA__CFG1, CYREG_UDB_PA1_CFG1
.set CapSense_CSD_Sns__PA__CFG10, CYREG_UDB_PA1_CFG10
.set CapSense_CSD_Sns__PA__CFG11, CYREG_UDB_PA1_CFG11
.set CapSense_CSD_Sns__PA__CFG12, CYREG_UDB_PA1_CFG12
.set CapSense_CSD_Sns__PA__CFG13, CYREG_UDB_PA1_CFG13
.set CapSense_CSD_Sns__PA__CFG14, CYREG_UDB_PA1_CFG14
.set CapSense_CSD_Sns__PA__CFG2, CYREG_UDB_PA1_CFG2
.set CapSense_CSD_Sns__PA__CFG3, CYREG_UDB_PA1_CFG3
.set CapSense_CSD_Sns__PA__CFG4, CYREG_UDB_PA1_CFG4
.set CapSense_CSD_Sns__PA__CFG5, CYREG_UDB_PA1_CFG5
.set CapSense_CSD_Sns__PA__CFG6, CYREG_UDB_PA1_CFG6
.set CapSense_CSD_Sns__PA__CFG7, CYREG_UDB_PA1_CFG7
.set CapSense_CSD_Sns__PA__CFG8, CYREG_UDB_PA1_CFG8
.set CapSense_CSD_Sns__PA__CFG9, CYREG_UDB_PA1_CFG9
.set CapSense_CSD_Sns__PC, CYREG_PRT1_PC
.set CapSense_CSD_Sns__PC2, CYREG_PRT1_PC2
.set CapSense_CSD_Sns__PORT, 1
.set CapSense_CSD_Sns__PS, CYREG_PRT1_PS

/* Miscellaneous */
.set CYDEV_BCLK__HFCLK__HZ, 24000000
.set CYDEV_BCLK__HFCLK__KHZ, 24000
.set CYDEV_BCLK__HFCLK__MHZ, 24
.set CYDEV_BCLK__SYSCLK__HZ, 24000000
.set CYDEV_BCLK__SYSCLK__KHZ, 24000
.set CYDEV_BCLK__SYSCLK__MHZ, 24
.set CYDEV_CHIP_DIE_LEOPARD, 1
.set CYDEV_CHIP_DIE_PANTHER, 4
.set CYDEV_CHIP_DIE_PSOC4A, 2
.set CYDEV_CHIP_DIE_PSOC5LP, 5
.set CYDEV_CHIP_DIE_UNKNOWN, 0
.set CYDEV_CHIP_FAMILY_PSOC3, 1
.set CYDEV_CHIP_FAMILY_PSOC4, 2
.set CYDEV_CHIP_FAMILY_PSOC5, 3
.set CYDEV_CHIP_FAMILY_UNKNOWN, 0
.set CYDEV_CHIP_FAMILY_USED, CYDEV_CHIP_FAMILY_PSOC4
.set CYDEV_CHIP_JTAG_ID, 0x04C81193
.set CYDEV_CHIP_MEMBER_3A, 1
.set CYDEV_CHIP_MEMBER_4A, 2
.set CYDEV_CHIP_MEMBER_4D, 3
.set CYDEV_CHIP_MEMBER_5A, 4
.set CYDEV_CHIP_MEMBER_5B, 5
.set CYDEV_CHIP_MEMBER_UNKNOWN, 0
.set CYDEV_CHIP_MEMBER_USED, CYDEV_CHIP_MEMBER_4A
.set CYDEV_CHIP_DIE_EXPECT, CYDEV_CHIP_MEMBER_USED
.set CYDEV_CHIP_DIE_ACTUAL, CYDEV_CHIP_DIE_EXPECT
.set CYDEV_CHIP_REV_LEOPARD_ES1, 0
.set CYDEV_CHIP_REV_LEOPARD_ES2, 1
.set CYDEV_CHIP_REV_LEOPARD_ES3, 3
.set CYDEV_CHIP_REV_LEOPARD_PRODUCTION, 3
.set CYDEV_CHIP_REV_PANTHER_ES0, 0
.set CYDEV_CHIP_REV_PANTHER_ES1, 1
.set CYDEV_CHIP_REV_PANTHER_PRODUCTION, 1
.set CYDEV_CHIP_REV_PSOC4A_ES0, 17
.set CYDEV_CHIP_REV_PSOC4A_PRODUCTION, 17
.set CYDEV_CHIP_REV_PSOC5LP_ES0, 0
.set CYDEV_CHIP_REV_PSOC5LP_PRODUCTION, 0
.set CYDEV_CHIP_REVISION_3A_ES1, 0
.set CYDEV_CHIP_REVISION_3A_ES2, 1
.set CYDEV_CHIP_REVISION_3A_ES3, 3
.set CYDEV_CHIP_REVISION_3A_PRODUCTION, 3
.set CYDEV_CHIP_REVISION_4A_ES0, 17
.set CYDEV_CHIP_REVISION_4A_PRODUCTION, 17
.set CYDEV_CHIP_REVISION_4D_ES0, 0
.set CYDEV_CHIP_REVISION_4D_PRODUCTION, 0
.set CYDEV_CHIP_REVISION_5A_ES0, 0
.set CYDEV_CHIP_REVISION_5A_ES1, 1
.set CYDEV_CHIP_REVISION_5A_PRODUCTION, 1
.set CYDEV_CHIP_REVISION_5B_ES0, 0
.set CYDEV_CHIP_REVISION_5B_PRODUCTION, 0
.set CYDEV_CHIP_REVISION_USED, CYDEV_CHIP_REVISION_4A_PRODUCTION
.set CYDEV_CHIP_REV_EXPECT, CYDEV_CHIP_REVISION_USED
.set CYDEV_CONFIG_READ_ACCELERATOR, 1
.set CYDEV_CONFIG_UNUSED_IO_AllowButWarn, 0
.set CYDEV_CONFIG_UNUSED_IO, CYDEV_CONFIG_UNUSED_IO_AllowButWarn
.set CYDEV_CONFIG_UNUSED_IO_AllowWithInfo, 1
.set CYDEV_CONFIG_UNUSED_IO_Disallowed, 2
.set CYDEV_CONFIGURATION_COMPRESSED, 1
.set CYDEV_CONFIGURATION_MODE_COMPRESSED, 0
.set CYDEV_CONFIGURATION_MODE, CYDEV_CONFIGURATION_MODE_COMPRESSED
.set CYDEV_CONFIGURATION_MODE_DMA, 2
.set CYDEV_CONFIGURATION_MODE_UNCOMPRESSED, 1
.set CYDEV_DEBUG_PROTECT_KILL, 4
.set CYDEV_DEBUG_PROTECT_OPEN, 1
.set CYDEV_DEBUG_PROTECT, CYDEV_DEBUG_PROTECT_OPEN
.set CYDEV_DEBUG_PROTECT_PROTECTED, 2
.set CYDEV_DEBUGGING_DPS_Disable, 3
.set CYDEV_DEBUGGING_DPS_SWD, 2
.set CYDEV_DEBUGGING_DPS, CYDEV_DEBUGGING_DPS_SWD
.set CYDEV_DEBUGGING_ENABLE, 1
.set CYDEV_HEAP_SIZE, 0x0100
.set CYDEV_PROJ_TYPE, 0
.set CYDEV_PROJ_TYPE_BOOTLOADER, 1
.set CYDEV_PROJ_TYPE_LOADABLE, 2
.set CYDEV_PROJ_TYPE_MULTIAPPBOOTLOADER, 3
.set CYDEV_PROJ_TYPE_STANDARD, 0
.set CYDEV_STACK_SIZE, 0x0400
.set CYDEV_USE_BUNDLED_CMSIS, 1
.set CYDEV_VARIABLE_VDDA, 1
.set CYDEV_VDDA_MV, 3300
.set CYDEV_VDDD_MV, 3300
.set CYIPBLOCK_M0S8_CTBM_VERSION, 0
.set CYIPBLOCK_m0s8cpuss_VERSION, 0
.set CYIPBLOCK_m0s8csd_VERSION, 0
.set CYIPBLOCK_m0s8gpio2_VERSION, 0
.set CYIPBLOCK_m0s8hsiom4a_VERSION, 0
.set CYIPBLOCK_m0s8lcd_VERSION, 0
.set CYIPBLOCK_m0s8lpcomp_VERSION, 0
.set CYIPBLOCK_m0s8pclk_VERSION, 0
.set CYIPBLOCK_m0s8sar_VERSION, 0
.set CYIPBLOCK_m0s8scb_VERSION, 0
.set CYIPBLOCK_m0s8srssv2_VERSION, 1
.set CYIPBLOCK_m0s8tcpwm_VERSION, 0
.set CYIPBLOCK_m0s8udbif_VERSION, 0
.set CYIPBLOCK_S8_GPIO_VERSION, 2
.set CYDEV_BOOTLOADER_ENABLE, 0
.endif
